/* Project-owned bindings; addresses come only from the pinned Microchip DFP.
 * Intentionally no include guard: consumers define AT13_IO_PUBLISH and
 * AT13_IO_LOCAL. The order of published writes is part of the existing board
 * boundary. This describes ownership/publication, not register side effects.
 * ADC/ADCW alias ADCL; EEAR aliases EEARL. List each byte address only once. */
AT13_IO_PUBLISH(ADC, ADCSRB, board.analog.adc.adcsrb)
AT13_IO_PUBLISH(ADC, ADCL, (board.analog.adc.admux&AT13_MASK_ADLAR)?board.analog.adc.result<<6:board.analog.adc.result)
AT13_IO_PUBLISH(ADC, ADCH, (board.analog.adc.admux&AT13_MASK_ADLAR)?board.analog.adc.result>>2:board.analog.adc.result>>8)
AT13_IO_PUBLISH(ADC, ADCSRA, board.analog.adc.adcsra)
AT13_IO_PUBLISH(ADC, ADMUX, board.analog.adc.admux)
AT13_IO_PUBLISH(COMPARATOR, ACSR, board.analog.comparator.acsr)
AT13_IO_PUBLISH(GPIO, DIDR0, board.gpio.didr0)
AT13_IO_PUBLISH(GPIO, PCMSK, board.gpio.pcmsk)
AT13_IO_PUBLISH(GPIO, PINB, board.gpio.pinb)
AT13_IO_PUBLISH(GPIO, DDRB, board.gpio.ddrb)
AT13_IO_PUBLISH(GPIO, PORTB, board.gpio.portb)
AT13_IO_PUBLISH(GPIO, MCUCR, board.gpio.mcucr)
AT13_IO_PUBLISH(GPIO, GIFR, board.gpio.gifr)
AT13_IO_PUBLISH(GPIO, GIMSK, board.gpio.gimsk)
AT13_IO_PUBLISH(WATCHDOG, WDTCR, board.watchdog.control)
AT13_IO_PUBLISH(WATCHDOG, MCUSR, board.watchdog.mcusr)
AT13_IO_PUBLISH(NVM, EECR, board.nvm.eecr)
AT13_IO_PUBLISH(NVM, EEDR, board.nvm.eedr)
AT13_IO_PUBLISH(NVM, EEARL, board.nvm.eearl)
AT13_IO_PUBLISH(NVM, SPMCSR, board.nvm.spmcsr)
AT13_IO_PUBLISH(BOARD, PRR, board.prr)
AT13_IO_PUBLISH(TIMER0, GTCCR, board.timer.gtccr)
AT13_IO_PUBLISH(TIMER0, TCCR0A, board.timer.tccra)
AT13_IO_PUBLISH(TIMER0, TCCR0B, board.timer.tccrb)
AT13_IO_PUBLISH(TIMER0, TCNT0, board.timer.tcnt)
AT13_IO_PUBLISH(TIMER0, OCR0A, board.timer.ocra)
AT13_IO_PUBLISH(TIMER0, OCR0B, board.timer.ocrb)
AT13_IO_PUBLISH(TIMER0, TIFR0, board.timer.tifr)
AT13_IO_PUBLISH(TIMER0, TIMSK0, board.timer.timsk)
AT13_IO_PUBLISH(BOARD, CLKPR, board.clkpr)
AT13_IO_PUBLISH(BOARD, BODCR, board.bodcr)
AT13_IO_LOCAL(CLOCK, OSCCAL)
AT13_IO_LOCAL(CPU, SPL)
AT13_IO_LOCAL(CPU, SREG)
AT13_IO_LOCAL(DEBUG, DWDR)
