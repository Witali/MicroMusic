/* Generated by scripts/generate-attiny13a-registers.mjs; do not edit. */
/* Numeric AVR I/O offsets, original bit positions and memory constants. */
.set ACBG,0x6
.set ACD,0x7
.set ACI,0x4
.set ACIE,0x3
.set ACIS0,0x0
.set ACIS1,0x1
.set ACME,0x6
.set ACO,0x5
.set ACSR,0x8
.set ADATE,0x5
.set ADC,0x4
.set ADC0D,0x5
.set ADC1D,0x2
.set ADC2D,0x4
.set ADC3D,0x3
.set ADCH,0x5
.set ADCH0,0x0
.set ADCH1,0x1
.set ADCH2,0x2
.set ADCH3,0x3
.set ADCH4,0x4
.set ADCH5,0x5
.set ADCH6,0x6
.set ADCH7,0x7
.set ADCL,0x4
.set ADCL0,0x0
.set ADCL1,0x1
.set ADCL2,0x2
.set ADCL3,0x3
.set ADCL4,0x4
.set ADCL5,0x5
.set ADCL6,0x6
.set ADCL7,0x7
.set ADCSRA,0x6
.set ADCSRB,0x3
.set ADCW,0x4
.set ADEN,0x7
.set ADIE,0x3
.set ADIF,0x4
.set ADLAR,0x5
.set ADMUX,0x7
.set ADPS0,0x0
.set ADPS1,0x1
.set ADPS2,0x2
.set ADSC,0x6
.set ADTS0,0x0
.set ADTS1,0x1
.set ADTS2,0x2
.set AIN0D,0x0
.set AIN1D,0x1
.set BODCR,0x30
.set BODS,0x1
.set BODSE,0x0
.set BORF,0x2
.set CAL0,0x0
.set CAL1,0x1
.set CAL2,0x2
.set CAL3,0x3
.set CAL4,0x4
.set CAL5,0x5
.set CAL6,0x6
.set CLKPCE,0x7
.set CLKPR,0x26
.set CLKPS0,0x0
.set CLKPS1,0x1
.set CLKPS2,0x2
.set CLKPS3,0x3
.set COM0A0,0x6
.set COM0A1,0x7
.set COM0B0,0x4
.set COM0B1,0x5
.set CS00,0x0
.set CS01,0x1
.set CS02,0x2
.set CTPB,0x4
.set DDB0,0x0
.set DDB1,0x1
.set DDB2,0x2
.set DDB3,0x3
.set DDB4,0x4
.set DDB5,0x5
.set DDRB,0x17
.set DIDR0,0x14
.set DWDR,0x2e
.set DWDR0,0x0
.set DWDR1,0x1
.set DWDR2,0x2
.set DWDR3,0x3
.set DWDR4,0x4
.set DWDR5,0x5
.set DWDR6,0x6
.set DWDR7,0x7
.set E2END,0x3f
.set E2PAGESIZE,0x4
.set EEAR,0x1e
.set EEAR0,0x0
.set EEAR1,0x1
.set EEAR2,0x2
.set EEAR3,0x3
.set EEAR4,0x4
.set EEAR5,0x5
.set EEARL,0x1e
.set EECR,0x1c
.set EEDR,0x1d
.set EEDR0,0x0
.set EEDR1,0x1
.set EEDR2,0x2
.set EEDR3,0x3
.set EEDR4,0x4
.set EEDR5,0x5
.set EEDR6,0x6
.set EEDR7,0x7
.set EEMPE,0x2
.set EEMWE,0x2
.set EEPE,0x1
.set EEPM0,0x4
.set EEPM1,0x5
.set EERE,0x0
.set EERIE,0x3
.set EEWE,0x1
.set EXTRF,0x1
.set FLASHEND,0x3ff
.set FOC0A,0x7
.set FOC0B,0x6
.set GIFR,0x3a
.set GIMSK,0x3b
.set GTCCR,0x28
.set INT0,0x6
.set INTF0,0x6
.set ISC00,0x0
.set ISC01,0x1
.set MCUCR,0x35
.set MCUSR,0x34
.set MUX0,0x0
.set MUX1,0x1
.set OCF0A,0x2
.set OCF0B,0x3
.set OCIE0A,0x2
.set OCIE0B,0x3
.set OCR0A,0x36
.set OCR0A_0,0x0
.set OCR0A_1,0x1
.set OCR0A_2,0x2
.set OCR0A_3,0x3
.set OCR0A_4,0x4
.set OCR0A_5,0x5
.set OCR0A_6,0x6
.set OCR0A_7,0x7
.set OCR0B,0x29
.set OCR0B_0,0x0
.set OCR0B_1,0x1
.set OCR0B_2,0x2
.set OCR0B_3,0x3
.set OCR0B_4,0x4
.set OCR0B_5,0x5
.set OCR0B_6,0x6
.set OCR0B_7,0x7
.set OSCCAL,0x31
.set PCIE,0x5
.set PCIF,0x5
.set PCINT0,0x0
.set PCINT1,0x1
.set PCINT2,0x2
.set PCINT3,0x3
.set PCINT4,0x4
.set PCINT5,0x5
.set PCMSK,0x15
.set PGERS,0x1
.set PGWRT,0x2
.set PINB,0x16
.set PINB0,0x0
.set PINB1,0x1
.set PINB2,0x2
.set PINB3,0x3
.set PINB4,0x4
.set PINB5,0x5
.set PORF,0x0
.set PORTB,0x18
.set PORTB0,0x0
.set PORTB1,0x1
.set PORTB2,0x2
.set PORTB3,0x3
.set PORTB4,0x4
.set PORTB5,0x5
.set PRADC,0x0
.set PRR,0x25
.set PRTIM0,0x1
.set PSR10,0x0
.set PUD,0x6
.set RAMEND,0x9f
.set RAMSIZE,0x40
.set RAMSTART,0x60
.set REFS0,0x6
.set RFLB,0x3
.set SE,0x5
.set SM0,0x3
.set SM1,0x4
.set SPL,0x3d
.set SPM_PAGESIZE,0x20
.set SPMCSR,0x37
.set SPMEN,0x0
.set SREG,0x3f
.set SREG_C,0x0
.set SREG_H,0x5
.set SREG_I,0x7
.set SREG_N,0x2
.set SREG_S,0x4
.set SREG_T,0x6
.set SREG_V,0x3
.set SREG_Z,0x1
.set TCCR0A,0x2f
.set TCCR0B,0x33
.set TCNT0,0x32
.set TCNT0_0,0x0
.set TCNT0_1,0x1
.set TCNT0_2,0x2
.set TCNT0_3,0x3
.set TCNT0_4,0x4
.set TCNT0_5,0x5
.set TCNT0_6,0x6
.set TCNT0_7,0x7
.set TIFR0,0x38
.set TIMSK0,0x39
.set TOIE0,0x1
.set TOV0,0x1
.set TSM,0x7
.set WDCE,0x4
.set WDE,0x3
.set WDP0,0x0
.set WDP1,0x1
.set WDP2,0x2
.set WDP3,0x5
.set WDRF,0x3
.set WDTCR,0x21
.set WDTIE,0x6
.set WDTIF,0x7
.set WGM00,0x0
.set WGM01,0x1
.set WGM02,0x3
.set ADC_vect_num,9
.set ANA_COMP_vect_num,5
.set EE_RDY_vect_num,4
.set INT0_vect_num,1
.set PCINT0_vect_num,2
.set RESET_vect_num,0
.set TIM0_COMPA_vect_num,6
.set TIM0_COMPB_vect_num,7
.set TIM0_OVF_vect_num,3
.set WDT_vect_num,8
.set AT13_IO_DATA_OFFSET,0x20
