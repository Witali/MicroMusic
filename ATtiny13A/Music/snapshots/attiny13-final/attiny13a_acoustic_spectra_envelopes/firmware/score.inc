/* GENERATED by generate.py. Do not edit by hand. */
.set REST_INDEX, 13
.set SAMPLE_CYCLES, 256
.set INSTR_LEAD, 1
.set INSTR_KEYS, 1
.set INSTR_PLUCK, 1
.set INSTR_DRUMS, 2

.balign 2
playlist:
  .byte 0x00, 0x01, 0x02, 0x03, 0x03, 0x04, 0x03, 0x03, 0x05, 0x05, 0x04, 0x03, 0x03, 0x05, 0x05, 0xff   /* 15 playback entries + loop marker */
durations:
  .byte 0x0e, 0x1b, 0x29, 0x37, 0x52, 0x6e, 0xdc   /* ticks @ 80 BPM, 512 PWM periods/tick */
note_steps:
  .byte 0x20, 0x01   /* E3, 164.8 Hz */
  .byte 0x43, 0x01   /* F#3, 184.8 Hz */
  .byte 0x57, 0x01   /* G3, 196.3 Hz */
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  .byte 0x02, 0x04   /* D5, 587.1 Hz */
chord_steps:
  .byte 0xb0, 0x01, 0x43, 0x01   /* Bm: piano B3, guitar F#3 */
  .byte 0x57, 0x01, 0x01, 0x01   /* Gmaj7: piano G3, guitar D3 */
  .byte 0x20, 0x01, 0xd8, 0x00   /* Em: piano E3, guitar B2 */
  .byte 0x43, 0x01, 0xf2, 0x00   /* F#m: piano F#3, guitar C#3 */
  .byte 0xf2, 0x00, 0xb5, 0x00   /* C#m7b5: piano C#3, guitar G#2 */
section_offsets:
  .byte 0x00, 0x15, 0x51, 0x90, 0xb3, 0xe5   /* byte offsets in melody_data */
melody_data:
section_intro:
  .byte 0xe0, 0x19, 0x39, 0x61, 0x40, 0x50, 0xe1, 0x11, 0x39, 0x5b, 0xe2, 0x01, 0x31, 0x51, 0x40, 0x50
  .byte 0xe3, 0x09, 0x31, 0x5b, 0xff
section_A:
  .byte 0xe0, 0x2d, 0xe1, 0x1b, 0x2a, 0x20, 0xe2, 0x34, 0x29, 0xe3, 0x3d, 0xe0, 0x2b, 0x33, 0xe1, 0x3b
  .byte 0x33, 0xe2, 0x33, 0x2a, 0x30, 0xe3, 0x25, 0xe0, 0x2b, 0x19, 0x41, 0xe1, 0x41, 0x39, 0x39, 0x40
  .byte 0x38, 0xe2, 0x33, 0x29, 0x31, 0xe3, 0x31, 0x41, 0x39, 0x31, 0xe0, 0x29, 0x18, 0x20, 0x29, 0x39
  .byte 0xe1, 0x31, 0x29, 0x31, 0x41, 0xe2, 0x43, 0x39, 0x31, 0xe3, 0x3d, 0xff
section_B:
  .byte 0xe0, 0x39, 0x39, 0x39, 0x30, 0x28, 0xe1, 0x39, 0x39, 0x39, 0x30, 0x28, 0xe2, 0x3b, 0x42, 0x38
  .byte 0xe3, 0x35, 0xe0, 0x39, 0x39, 0x39, 0x30, 0x28, 0xe1, 0x3b, 0x39, 0x40, 0x38, 0xe2, 0x33, 0x2a
  .byte 0x30, 0xe3, 0x25, 0xe0, 0x53, 0x4a, 0x40, 0xe1, 0x3c, 0x31, 0xe2, 0x2c, 0x19, 0xe3, 0x34, 0x29
  .byte 0xe0, 0x19, 0x21, 0x29, 0x31, 0xe1, 0x3c, 0x30, 0x28, 0xe2, 0x44, 0x39, 0xe3, 0x35, 0xff
section_C:
  .byte 0xe0, 0x39, 0x39, 0x39, 0x30, 0x28, 0xe1, 0x39, 0x39, 0x39, 0x30, 0x28, 0xe2, 0x44, 0x39, 0xe3
  .byte 0x35, 0xe0, 0x39, 0x39, 0x39, 0x30, 0x28, 0xe1, 0x3b, 0x39, 0x40, 0x38, 0xe2, 0x33, 0x2a, 0x30
  .byte 0xe3, 0x25, 0xff
section_D:
  .byte 0xe0, 0x3b, 0x6b, 0xe1, 0x33, 0x6b, 0xe2, 0x2b, 0x6b, 0xe3, 0x23, 0x6b, 0xe1, 0x2b, 0x6b, 0xe2
  .byte 0x33, 0x6b, 0xe4, 0x43, 0x6b, 0xe3, 0x3b, 0x6b, 0xe0, 0x3c, 0x49, 0xe1, 0x44, 0x41, 0xe2, 0x49
  .byte 0x41, 0x41, 0x39, 0xe3, 0x35, 0xe0, 0x33, 0x3b, 0xe1, 0x3b, 0x43, 0xe2, 0x4b, 0x41, 0x39, 0xe3
  .byte 0x45, 0xff
section_F:
  .byte 0xe0, 0x6d, 0xe1, 0x6d, 0xe2, 0x6d, 0xe3, 0x6d, 0xe0, 0x6d, 0xe1, 0x6d, 0xe2, 0x6d, 0xe3, 0x6d
  .byte 0xff
