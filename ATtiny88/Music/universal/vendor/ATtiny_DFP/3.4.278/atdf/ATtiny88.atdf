# ATtiny88 device description
Architecture: AVR8; Family: tinyAVR
Programming and debug interfaces: ISP, HVPP, debugWIRE
Registers are 8-bit, access not given, no defined reset value unless marked. A register's access mark holds for its fields unless they carry their own. Offsets are from the block's base; lines under a group give offsets from that group; [hi:lo] are bit positions; {n}, {i} and the like mark numbered series; 'fields as' and 'values as' point back to an identical list; <NAME> marks a mode.

## Ordering variants
ATtiny88-MMU, ATtiny88-MMH: QFN28, up to 12 MHz, -40 to 85 C, 1.8 to 5.5 V
ATtiny88-PU: PDIP28, pinout PDIP, up to 12 MHz, -40 to 85 C, 1.8 to 5.5 V
ATtiny88-AU: TQFP32, pinout TQFP32_QFN32, up to 12 MHz, -40 to 85 C, 1.8 to 5.5 V
ATtiny88-CCU: UFBGA32, pinout UFBGA, up to 12 MHz, -40 to 85 C, 1.8 to 5.5 V
ATtiny88-MU: QFN32, pinout TQFP32_QFN32, up to 12 MHz, -40 to 85 C, 1.8 to 5.5 V

## Memory
prog space: start 0x0000 size 0x2000, little endian
  0x0000 FLASH size 0x2000 flash, rw, executable, page 0x40
signatures space: start 0 size 3, little endian
  0 SIGNATURES size 3 signatures, ro
fuses space: start 0 size 0x0003, little endian
  0 FUSES size 0x0003 fuses, rw
lockbits space: start 0 size 0x0001, little endian
  0 LOCKBITS size 0x0001 lockbits, rw
data space: start 0x0000 size 0x0300, little endian
  0x0000 REGISTERS size 0x0020 regs
  0x0020 MAPPED_IO size 0x00e0 io
  0x0100 IRAM size 0x0200 ram
eeprom space: start 0x0000 size 0x0040, little endian
  0x0000 EEPROM size 0x0040 eeprom, rw, page 0x04
io space: start 0x00 size 0x40, little endian
osccal space: start 0 size 1, little endian
  0 OSCCAL size 1 osccal, ro

## Peripheral instances (address, pins/pin function, parameters)
TC1 at 0x00 — Timer/Counter, 16-bit
  pins: T PD5; ICP PB0; OCA PB1; OCB PB3
AC at 0x00 — Analog Comparator
  pins: AIN0 PD6; AIN1 PD7
PORTB at 0x00 — I/O Port
  pins: P{n} PB{n} (n=0..7)
PORTD at 0x00 — I/O Port
  pins: P{n} PD{n} (n=0..7)
PORTC at 0x00 — I/O Port
  pins: P{n} PC{n} (n=0..7)
PORTA at 0x00 — I/O Port
  pins: P0 PA0; P1 PA1; P2 PA2; P3 PA3
SPI at 0x00 — Serial Peripheral Interface
  pins: SCK PB5; MISO PB4; MOSI PB3; SS PB2
WDT at 0x00 — Watchdog Timer
TWI at 0x00 — Two Wire Serial Interface
  pins: SCL PC6; SDA PC5
ADC at 0x00 — Analog-to-Digital Converter
  pins: ADC0 PC0; ADC1 PC1; ADC2 PC2; ADC3 PC3; ADC4 PC4; ADC5 PC5; ADC6 PA0; ADC7 PA1
EXINT at 0x00 — External Interrupts
  pins: PCINT{n} PB{n} (n=0..7); PCINT{n} PC{n-8} (n=8..15); PCINT{n} PD{n-16} (n=16..23); PCINT24 PA0; PCINT25 PA1; PCINT26 PA2; PCINT27 PA3; INT0 PD2; INT1 PD3
TC0 at 0x00 — Timer/Counter, 8-bit
  pins: T PD4
CPU at 0x00 — CPU Registers
  parameters: CORE_VERSION=V2, NEW_INSTRUCTIONS=lpm rd,z+
EEPROM at 0x00
FUSE at 0 in fuses — Fuses
LOCKBIT at 0 in lockbits — Lockbits

## Interrupts
0 RESET — External Pin, Power-on Reset, Brown-out Reset and Watchdog Reset
1 INT0 — External Interrupt Request 0
2 INT1 — External Interrupt Request 1
3 PCINT0 — Pin Change Interrupt Request 0
4 PCINT1 — Pin Change Interrupt Request 1
5 PCINT2 — Pin Change Interrupt Request 2
6 PCINT3 — Pin Change Interrupt Request 3
7 WDT — Watchdog Time-out Interrupt
8 TIMER1_CAPT — Timer/Counter1 Capture Event
9 TIMER1_COMPA — Timer/Counter1 Compare Match A
10 TIMER1_COMPB — Timer/Counter1 Compare Match B
11 TIMER1_OVF — Timer/Counter1 Overflow
12 TIMER0_COMPA — TimerCounter0 Compare Match A
13 TIMER0_COMPB — TimerCounter0 Compare Match B
14 TIMER0_OVF — Timer/Counter0 Overflow
15 SPI_STC — SPI Serial Transfer Complete
16 ADC — ADC Conversion Complete
17 EE_RDY — EEPROM Ready
18 ANALOG_COMP — Analog Comparator
19 TWI — Two-wire Serial Interface

## Properties
SIGNATURES: JTAGID=0x9311, SIGNATURE0=0x1e, SIGNATURE1=0x93, SIGNATURE2=0x11
OCD: OCD_REVISION=1, OCD_DATAREG=0x31, PROGBASE=0x0000

## Pinouts (pin number, pad)
TQFP32_QFN32: 1 PD3, 2 PD4, 3 PA2, 4 VCC, 5 GND, 6 PA3, 7 PB6, 8 PB7, 9 PD5, 10 PD6, 11 PD7, 12 PB0, 13 PB1, 14 PB2, 15 PB3, 16 PB4, 17 PB5, 18 AVCC, 19 PA0, 20 PC7, 21 GND, 22 PA1, 23 PC0, 24 PC1, 25 PC2, 26 PC3, 27 PC4, 28 PC5, 29 PC6, 30 PD0, 31 PD1, 32 PD2
PDIP: 1 PC6, 2 PD0, 3 PD1, 4 PD2, 5 PD3, 6 PD4, 7 VCC, 8 GND, 9 PB6, 10 PB7, 11 PD5, 12 PD6, 13 PD7, 14 PB0, 15 PB1, 16 PB2, 17 PB3, 18 PB4, 19 PB5, 20 AVCC, 21 PC7, 22 GND, 23 PC0, 24 PC1, 25 PC2, 26 PC3, 27 PC4, 28 PC5
QFN28: 1 PD3, 2 PD4, 3 VCC, 4 GND, 5 PB6, 6 PB7, 7 PD5, 8 PD6, 9 PD7, 10 PB0, 11 PB1, 12 PB2, 13 PB3, 14 PB4, 15 PB5, 16 AVCC, 17 PC7, 18 GND, 19 PC0, 20 PC1, 21 PC2, 22 PC3, 23 PC4, 24 PC5, 25 PC6, 26 PD0, 27 PD1, 28 PD2
UFBGA: A1 PD2, B1 PD3, C1 GND, D1 VCC, E1 PB6, F1 PB7, A2 PD1, B2 PD4, C2 PA2, D2 PA3, E2 PD6, F2 PD5, A3 PC6, B3 PD0, E3 PB0, F3 PD7, A4 PC4, B4 PC5, E4 PB2, F4 PB1, A5 PC2, B5 PC3, C5 PA1, D5 PC7, E5 AVCC, F5 PB3, A6 PC1, B6 PC0, C6 GND, D6 PA0, E6 PB5, F6 PB4
