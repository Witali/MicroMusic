/* Generated by tools/build-attiny88-music.py. */
#include <avr/io.h>
.set BASE_COUNT, 59
.set STREAM_SECOND, 117
.section .text,"ax",@progbits
.global vectors
vectors:
  rjmp reset
  rjmp unused_irq
  rjmp unused_irq
  rjmp unused_irq
  rjmp unused_irq
  rjmp unused_irq
  rjmp unused_irq
  rjmp unused_irq
  rjmp unused_irq
  rjmp unused_irq
  rjmp unused_irq
  rjmp pwm_irq
  rjmp unused_irq
  rjmp unused_irq
  rjmp unused_irq
  rjmp unused_irq
  rjmp unused_irq
  rjmp unused_irq
  rjmp unused_irq
  rjmp unused_irq
unused_irq:
  rjmp reset
gain_finish:
  adc r17, r17
gain_return:
  ret
reset:
  /* ATtiny88: explicit stack, watchdog and board clock prescaler setup. */
  cli
  wdr
  ldi r16, 2
  out 62, r16
  ldi r16, 255
  out 61, r16
  clr r17
  out 52, r17
  lds r16, 96
  ori r16, 24
  sts 96, r16
  sts 96, r17
  ldi r16, 128
  sts 97, r16
  sts 97, r17
  sts 100, r17
  /* Clear interrupt sources left by the USB bootloader. */
  out _SFR_IO_ADDR(EIMSK), r17
  sts _SFR_MEM_ADDR(PCICR), r17
  sts _SFR_MEM_ADDR(TIMSK0), r17
  out _SFR_IO_ADDR(TCCR0A), r17
  sts _SFR_MEM_ADDR(ADCSRA), r17
  out _SFR_IO_ADDR(ACSR), r17
  ldi r16, 4
  out 42, r16
  ldi r16, 1
  out 43, r16
  ldi r27, 1
  clr r29
  ldi r31, 1
  ldi r30, 96
  ldi r18, 128
fill_ring:
  st Z+, r18
  cpi r30, 112
  brne fill_ring
  clr r16
clear_voices:
  st Z+, r16
  cpi r30, 152
  brne clear_voices
  clr r27
  ldi r26, 0
clear_registers:
  st X+, r16
  cpi r26, 16
  brne clear_registers
  ldi r27, 1
  ldi r16, 1
  out 30, r16
  mov r1, r16
  sub r6, r16
  mov r9, r16
  ldi r16, STREAM_SECOND
  mov r8, r16
  mov r23, r18
  ldi r28, 96
  rcall music_step
  ldi r30, 110
  ldi r31, 1
  /* Fast PWM mode5, TOP255; high-byte TEMP remains zero. */
  clr r16
  sts 129, r16
  sts 111, r16
  sts 133, r16
  sts 132, r16
  sts 137, r16
  sts 139, r16
  sts 136, r18
  sts 138, r18
  ldi r16, 33
  sts 128, r16
  /* Configure OC1x before enabling the pin driver (doc8008, section 12.7.3). */
  sbi 4, 2

  ldi r16, 1
  out 22, r16
  sts 111, r16
  ldi r16, 9
  sts 129, r16
  sei
idle:
  mov r16, r30
  sub r16, r28
  andi r16, 15
  cpi r16, 13
  brcc idle
audio_step:
  in r16, 42
  subi r16, 3
  ldi r17, 0
  brcc tiny88_fraction_ready
  subi r16, 251
  ldi r17, 1
tiny88_fraction_ready:
  out 42, r16
  out 43, r17
  add r15, r17
  brcc render_sample
  push r30
  rcall music_tick
  pop r30
  ldi r31, 1
render_sample:
  ldi r19, 0
  ldi r26, 112
  ldi r21, 232
voice_loop:
  ld r16, X+
  ld r17, X+
  ld r24, X+
  ld r25, X+
  add r16, r24
  adc r17, r25
  subi r26, 4
  st X+, r16
  st X+, r17
  subi r26, 254
  mov r16, r19
  cpi r25, 2
  brne tiny88_register_decided
  mov r25, r24
  cpi r25, 102
tiny88_register_decided:
  brcs wave_register
  ori r16, 8
wave_register:
  swap r17
  andi r17, 15
  lsr r17
  or r16, r17
  movw r24, r30
  mov r30, r16
  ldi r31, hi8(embedded_wave_bank)
tiny88_flash_read_0:
  lpm r17, Z
  movw r30, r24
  brcc wave_nibble
  swap r17
wave_nibble:
  andi r17, 15
  add r21, r17
  cpi r26, 124
  brne rhythm_group
  mov r25, r4
  andi r25, 15
  rcall chord_gain
  mov r20, r17
  ldi r19, 16
  ldi r21, 232
rhythm_group:
  cpi r26, 136
  brne voice_loop
  mov r25, r5
  andi r25, 15
  rcall chord_gain
  asr r17
  add r20, r17
render_drum:
  clr r17
  sbrs r6, 2
  rjmp drum_mixed
  sbrc r6, 3
  rjmp render_hat
render_kick:
  in r25, 43
  add r22, r25
  mov r17, r22
  sbrc r17, 7
  com r17
  subi r17, 61
  asr r17
  asr r17
  rjmp drum_gain
render_hat:
  lsl r22
  adc r7, r7
  brcc noise_advanced
  ldi r25, 45
  eor r22, r25
noise_advanced:
  mov r17, r22
  lsr r17
  andi r17, 63
  mov r25, r22
  andi r25, 63
  sub r17, r25
  asr r17
  asr r17
drum_gain:
  sbrs r6, 0
  asr r17
  sbrs r6, 1
  asr r17
  subi r17, 252
  asr r17
  asr r17
  asr r17
drum_mixed:
  add r17, r20
master_gain:
  lsl r17
  lsl r17
write_pwm:
  subi r17, 128
  add r23, r17
  ror r23
  st Z+, r23
  st Z+, r17
  andi r30, 111
  mov r23, r17
ring_published:
  rjmp idle
pwm_irq:
  sts 138, r18
ring_read:
  ldi r29, 1
  ld r18, Y+
  ldi r29, 0
  sbrc r28, 4
  ldi r28, 96
  reti
chord_gain:
  clr r17
  ldi r24, 4
  lsr r25
gain_loop:
  brcc gain_no_add
  add r17, r21
gain_no_add:
  asr r17
  ror r25
  dec r24
  brne gain_loop
  lsl r25
  rjmp gain_finish
music_tick:
  inc r14
  sbrc r14, 0
  rjmp drum_envelope_done
  sbrc r6, 2
  dec r6
drum_envelope_done:
  mov r20, r4
  rcall envelope
  mov r4, r20
  mov r20, r5
  rcall envelope
  mov r5, r20
  mov r16, r1
  or r16, r9
  brne song_running
  mov r16, r4
  or r16, r5
  brne music_return
  tst r2
  brne pause_count
  ldi r16, 74
  mov r2, r16
pause_count:
  dec r2
  brne music_return
restart_song:
  ldi r16, 15
  mov r6, r16
  clr r0
  ldi r16, 1
  out 30, r16
  mov r1, r16
  mov r9, r16
  ldi r16, STREAM_SECOND
  mov r8, r16
  clr r3
  clr r10
  clr r11
  clr r12
  clr r13
  rjmp music_step
song_running:
  ldi r16, 10
  add r12, r16
  ldi r16, 44
  adc r13, r16
  brcc music_return
music_step:
  in r16, 30
  dec r16
  brne drum_count_saved
  ldi r16, 3
  ldi r21, 8
  eor r6, r21
  ldi r21, 7
  or r6, r21
drum_trigger:
  ldi r22, 167
drum_count_saved:
  out 30, r16
  push r6
  push r7
  movw r16, r0
  movw r24, r2
  mov r20, r4
  ldi r19, 144
  rcall part_tick
  movw r0, r16
  movw r2, r24
  mov r4, r20
  movw r16, r8
  movw r24, r10
  mov r20, r5
  ldi r19, 148
  rcall part_tick
  movw r8, r16
  movw r10, r24
  mov r5, r20
  pop r7
  pop r6
music_return:
  ret
envelope:
  mov r21, r20
  andi r21, 15
  breq envelope_return
  sbrs r20, 7
  rjmp envelope_decay
  ldi r25, 1
  cpi r21, 10
  brcc envelope_mask
  ldi r25, 3
  cpi r21, 7
  brcc envelope_mask
  ldi r25, 7
envelope_mask:
  and r25, r14
  brne envelope_return
envelope_decay:
  dec r20
envelope_return:
  ret
part_tick:
  tst r17
  breq part_return
  dec r17
  brne part_return
  sbrc r25, 7
  rjmp read_base
  andi r20, 127
next_symbol:
  tst r24
  breq read_stream
  dec r24
  mov r26, r24
  add r26, r19
  ld r21, X+
  rjmp classify_symbol
read_stream:
  ldi r30, lo8(song_stream)
  ldi r31, hi8(song_stream)
  add r30, r16
  adc r31, r29
  lpm r21, Z
  inc r16
  cpi r21, 255
  breq part_return
classify_symbol:
  cpi r21, BASE_COUNT
  brcs symbol_base
  subi r21, BASE_COUNT
  lsl r21
  ldi r30, lo8(song_rules)
  ldi r31, hi8(song_rules)
  add r30, r21
  adc r31, r29
  lpm r6, Z+
  lpm r7, Z
  mov r26, r24
  add r26, r19
  st X+, r7
  inc r24
  mov r21, r6
  rjmp classify_symbol
symbol_base:
  mov r25, r21
read_base:
  mov r21, r25
  andi r21, 127
  lsl r21
  ldi r30, lo8(song_bases)
  ldi r31, hi8(song_bases)
  add r30, r21
  adc r31, r29
  lpm r6, Z+
  lpm r7, Z
  sbrc r25, 7
  rjmp note_start
  mov r17, r7
  lsr r17
  lsr r17
  andi r17, 62
  tst r17
  breq note_start
  ori r25, 128
part_return:
  ret
note_start:
  andi r25, 127
  mov r17, r7
  andi r17, 7
  ldi r30, lo8(song_gates)
  ldi r31, hi8(song_gates)
  add r30, r17
  adc r31, r29
  lpm r17, Z
  ldi r20, 143
  ldi r30, lo8(song_shapes)
  ldi r31, hi8(song_shapes)
  add r30, r6
  adc r31, r29
  ldi r26, 112
  sbrc r19, 2
  ldi r26, 124
  ldi r21, 12
clear_chord:
  st X+, r29
  dec r21
  brne clear_chord
  subi r26, 12
load_chord:
  lpm r6, Z+
  mov r25, r6
  andi r25, 127
  push r30
  push r31
  mov r30, r25
  ldi r31, hi8(embedded_wave_bank)
tiny88_flash_read_1:
  lpm r7, Z
  pop r31
  pop r30
  subi r26, 254
  st X+, r7
  inc r25
  push r30
  push r31
  mov r30, r25
  ldi r31, hi8(embedded_wave_bank)
tiny88_flash_read_2:
  lpm r7, Z
  pop r31
  pop r30
  st X+, r7
  sbrs r6, 7
  rjmp load_chord
chord_loaded:
  ret
song_shapes:
.byte 186,58,182,60,184,178,56,180,176,52,176,54,178,172,180,188,184,182,168,166,58,52,176,174,164,52,44,170,50,44,168,160,162
song_bases:
.byte 0,0,1,0,1,8,3,8,5,0,6,9,8,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24
song_rules:
.byte 0,17,25,16,1,2,0,16,8,7,59,4,3,61,4,60,17,18,65,4,66,25,7,63,16,21,17,16,38,38,59,0,60,69,62,18,71,0,53,54,55,56,78,78,79,79,81,80,55,54,55,57,84,83
song_stream:
.byte 0,61,1,68,68,5,6,7,70,2,70,1,63,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255
song_gates:
.byte 2,6,4,24,12,1,3

music_data_end:

.balign 256
embedded_wave_bank:
  .byte 184,220,171,153,136,135,54,65,220,139,135,203,138,53,67,133
  .byte 168,204,171,153,136,120,70,83,152,186,138,69,68,134,203,155
  .byte 173,0,231,0,3,1,90,1,155,1,205,1,6,2,69,2
  .byte 140,2,179,2,8,3,54,3,155,3,12,4,73,4,0,0
