/* Generated by tools/build-attiny88-music.py. */
#include <avr/io.h>
.section .text,"ax",@progbits
.global vectors
.set REST_INDEX, 17
.set HOLD_INDEX, 18
.set PLAYLIST_LEN, 32
.set FIRST_PLAYLIST_INDEX, 1
.set GRID_STEP_LOW, 159
.set GRID_STEP_HIGH, 32
.set GRID_INITIAL_HIGH, 224
vectors:
  rjmp reset
  rjmp unused_irq
  rjmp unused_irq
  rjmp unused_irq
  rjmp unused_irq
  rjmp unused_irq
  rjmp unused_irq
  rjmp unused_irq
  rjmp unused_irq
  rjmp unused_irq
  rjmp unused_irq
  rjmp pwm_irq
  rjmp unused_irq
  rjmp unused_irq
  rjmp unused_irq
  rjmp unused_irq
  rjmp unused_irq
  rjmp unused_irq
  rjmp unused_irq
  rjmp unused_irq
unused_irq:
  rjmp reset
voice_silent:
  clr r17
envelope_return:
  ret
render_tone:
  /* Choose a register-dependent 16-step sustain wavetable and apply its amplitude envelope. */
  mov r0, r25
  andi r25, 15
  breq voice_silent
  cpi r16, 2
  brne tiny88_register_decided
  mov r16, r6
  cpi r16, 102
tiny88_register_decided:
  mov r16, r0
  andi r16, 48
  brcs .L216
  ori r16, 8
.L216:
  cpi r26, 108
  brcc piano_attack_done
  cpi r25, 14
  brcs piano_attack_done
  ori r16, 48
piano_attack_done:
  swap r17
  andi r17, 15
  lsr r17
  or r16, r17
  movw r10, r30
  mov r30, r16
  ldi r31, hi8(embedded_wave_bank)
tiny88_flash_read_0:
  lpm r17, Z
  movw r30, r10
  brcc eeprom_low_nibble
  swap r17
eeprom_low_nibble:
  andi r17, 15
.L25c:
  movw r10, r30
  swap r25
  or r25, r17
  mov r30, r25
  ldi r31, hi8(amplitude_gain)
  lpm r17, Z
  movw r30, r10
  ret
reset:
  /* ATtiny88: explicit stack, watchdog and board clock prescaler setup. */
  cli
  wdr
  ldi r16, 2
  out 62, r16
  ldi r16, 255
  out 61, r16
  clr r17
  out 52, r17
  lds r16, 96
  ori r16, 24
  sts 96, r16
  sts 96, r17
  ldi r16, 128
  sts 97, r16
  sts 97, r17
  sts 100, r17
  /* Clear interrupt sources left by the USB bootloader. */
  out _SFR_IO_ADDR(EIMSK), r17
  sts _SFR_MEM_ADDR(PCICR), r17
  sts _SFR_MEM_ADDR(TIMSK0), r17
  out _SFR_IO_ADDR(TCCR0A), r17
  sts _SFR_MEM_ADDR(ADCSRA), r17
  out _SFR_IO_ADDR(ACSR), r17
  ldi r16, 4
  out 42, r16
  ldi r16, 1
  out 43, r16
  clr r29
  ldi r27, 1
  clr r2
  clr r15
  clr r24
  ldi r16, 255
  mov r8, r16
  ldi r16, 128
  mov r14, r16
  ldi r30, 97
  ldi r31, 1
clear_ram:
  st Z+, r29
  cpi r30, 128
  brne clear_ram
  ldi r18, 128
fill_ring:
  st Z+, r18
  cpi r30, 144
  brne fill_ring
  mov r23, r18
  ldi r28, 128
  ldi r22, 142
  ldi r16, 1
  mov r1, r16
  mov r4, r16
  ldi r16, GRID_INITIAL_HIGH
  mov r3, r16
  ldi r30, lo8(first_section)
  ldi r31, hi8(first_section)
  /* Fast PWM mode5, TOP255; high-byte TEMP remains zero. */
  clr r16
  sts 129, r16
  sts 111, r16
  sts 133, r16
  sts 132, r16
  sts 137, r16
  sts 139, r16
  sts 136, r18
  sts 138, r18
  ldi r16, 33
  sts 128, r16
  /* Configure OC1x before enabling the pin driver (doc8008, section 12.7.3). */
  sbi 4, 2

  ldi r16, 1
  out 22, r16
  sts 111, r16
  ldi r16, 9
  sts 129, r16
  sei
idle:
  mov r16, r22
  sub r16, r28
  andi r16, 15
check_space:
  cpi r16, 13
  brcc idle
audio_step:
  in r16, 42
  subi r16, 3
  ldi r17, 0
  brcc tiny88_fraction_ready
  subi r16, 251
  ldi r17, 1
tiny88_fraction_ready:
  out 42, r16
  out 43, r17
  add r15, r17
  brcc render_sample
  rcall music_tick
render_sample:
  ldi r26, 97
  clr r21
voice_loop:
  ld r25, X+
  ld r16, X+
  ld r7, X+
  ld r6, X+
  ld r17, X+
  andi r17, 127
  add r16, r6
  adc r7, r17
  subi r26, 4
  st X+, r16
  st X+, r7
  subi r26, 254
  mov r16, r17
  mov r17, r7
  rcall render_tone
  sbrc r26, 4
  asr r17
primary_gain:
  add r21, r17
  cpi r26, 127
  brne voice_loop
write_pwm:
  subi r21, 128
  mov r16, r23
  add r16, r21
  ror r16
  mov r26, r22
  st X+, r16
  st X+, r21
  mov r22, r26
  andi r22, 143
ring_published:
  mov r23, r21
  rjmp idle
pwm_irq:
  sts 138, r18
ring_read:
  ldi r29, 1
  ld r18, Y+
  ldi r29, 0
  sbrc r28, 4
  ldi r28, 128
irq_restore:
  reti
music_tick:
  inc r24
  ldi r26, 97
envelope_loop:
  ld r16, X+
  mov r17, r16
  andi r17, 15
  sbrs r16, 7
  rjmp state_release
  sbrs r16, 5
  rjmp state_plucked
  sbrc r24, 0
  rjmp envelope_store
  cpi r17, 7
  breq envelope_store
  inc r16
  rjmp envelope_store
state_plucked:
  tst r17
  breq envelope_store
  ldi r25, 15
  cpi r17, 7
  brcs state_mask
  ldi r25, 7
  cpi r17, 10
  brcs state_mask
  ldi r25, 3
state_mask:
  subi r26, 253
  ld r0, X+
  subi r26, 4
  sbrc r0, 7
  lsr r25
  sbrc r0, 7
  lsr r25
state_gate:
  and r25, r24
  brne envelope_store
  dec r16
  rjmp envelope_store
state_release:
  sbrs r16, 5
  rjmp ordinary_release
  mov r25, r24
  andi r25, 7
  brne envelope_store
ordinary_release:
  subi r17, 1
  brcs envelope_store
  breq release_last_level
  sbrc r16, 6
  dec r16
release_last_level:
  dec r16
envelope_store:
  st -X, r16
  subi r26, 251
  cpi r26, 127
  brne envelope_loop
.L0a8:
  ldi r17, GRID_STEP_LOW
  add r2, r17
  ldi r17, GRID_STEP_HIGH
  adc r3, r17
  brcs grid_step
  ret
grid_step:
  inc r8
  mov r16, r8
  andi r16, 15
  brne bar_clock_done
  inc r9
bar_clock_done:
.L0ba:
  dec r1
  breq read_event
  rjmp companion_grid
next_section:
  /* Playlist contains direct section offsets: no second lookup table. */
  ldi r30, lo8(playlist)
  ldi r31, hi8(playlist)
  add r30, r4
  adc r31, r29
  lpm r16, Z
  inc r4
  mov r17, r4
  cpi r17, PLAYLIST_LEN
  brne .L15c
  clr r4
.L15c:
  ldi r30, lo8(melody_data)
  ldi r31, hi8(melody_data)
  add r30, r16
  adc r31, r29
  rjmp read_event
read_event:
  /* Read packed score tokens. F0..FF are control events; E0..EF update accompaniment harmony. */
  lpm r16, Z+
  cpi r16, 255
  breq next_section
.L0c8:
  cpi r16, 151
  brcs melodic_event
  cpi r16, 254
  breq all_parts_off
chord_event:
  sbrs r14, 7
  rjmp macro_already_running
  clr r9
macro_already_running:
  subi r16, 142
  mov r14, r16
  rjmp read_event
all_parts_off:
  ldi r26, 97
all_parts_off_loop:
  ld r16, X
  andi r16, 127
  st X, r16
  subi r26, 251
  cpi r26, 117
  brne all_parts_off_loop
  ldi r16, 128
  mov r14, r16
  rjmp read_event
melodic_event:
  /* Decode compact note/duration; load 16-bit DDS increment or signal lead release. */
  movw r12, r30
  mov r17, r16
  andi r17, 7
  ldi r30, lo8(durations)
  ldi r31, hi8(durations)
  add r30, r17
  adc r31, r29
  lpm r1, Z
  /* BEGIN LEAD FREQUENCY */
  lsr r16
  lsr r16
  lsr r16
  cpi r16, REST_INDEX
  breq note_rest
  brcc hold_sample
  ldi r26, 97
  ldi r25, 207
  rcall macro_note
lead_commit:
  rjmp hold_sample
note_rest:
release_lead:
  ldi r26, 97
  ld r17, X
  andi r17, 127
  st X, r17
  rjmp companion_grid
hold_sample:
companion_grid:
  mov r16, r9
  subi r16, 112
  cpi r16, 28
  brcc continuation_done
  ldi r16, 10
  ldi r26, 97
  ldi r25, 167
  rcall macro_note
continuation_done:
  movw r30, r12
  sbrc r14, 7
  ret
  mov r16, r8
  andi r16, 3
  breq companion_quarter
  cpi r16, 2
  brne companion_done
  ldi r26, 102
  ld r16, X
  andi r16, 127
  st X, r16
  rjmp companion_done
companion_quarter:
  mov r16, r14
  andi r16, 15
  cpi r16, 15
  breq companion_bass
  ldi r26, 102
  ldi r25, 199
  rcall macro_note
companion_bass:
  sbrc r14, 6
  rjmp companion_bass_on
  mov r16, r8
  andi r16, 15
  brne companion_done
companion_bass_on:
  mov r16, r14
  swap r16
  andi r16, 3
  cpi r16, 3
  breq companion_strings
  subi r16, 239
  ldi r26, 107
  ldi r25, 151
  rcall macro_note
companion_strings:
  mov r16, r8
  andi r16, 15
  brne companion_done
  mov r16, r9
  cpi r16, 8
  brcs companion_done
  mov r16, r14
  swap r16
  andi r16, 3
  cpi r16, 3
  brne companion_pad_pitch
  ldi r16, 2
companion_pad_pitch:
  ldi r26, 112
  ldi r25, 160
  rcall macro_note
companion_done:
  movw r30, r12
  ret
macro_note:
  lsl r16
  ldi r30, lo8(note_steps)
  ldi r31, hi8(note_steps)
  add r30, r16
  adc r31, r29
  rjmp initialize_voice
initialize_voice:
  rcall capture_ram_tail
  andi r16, 15
  lsr r16
  or r16, r25
  st -X, r16
  subi r26, 253
  lpm r16, Z+
  st X+, r16
  lpm r16, Z+
  st X+, r16
voice_initialized:
  ret
capture_ram_tail:
  movw r10, r30
  lds r16, 373
  andi r16, 15
  lds r17, 378
  andi r17, 15
  sub r16, r17
  ldi r30, 117
  brcs ram_tail_destination
  ldi r30, 122
ram_tail_destination:
  ld r16, X+
  andi r16, 127
  mov r17, r16
  andi r17, 15
  breq no_ram_tail
  ldi r31, 1
  st Z+, r16
  ldi r17, 4
ram_tail_copy:
  ld r0, X+
  st Z+, r0
  dec r17
  brne ram_tail_copy
  subi r26, 4
no_ram_tail:
  movw r30, r10
  rjmp envelope_return
code_end:
playlist:
  .byte 0,12,7,241,23,0,28,48,77,48,90,101,10,100,160,164,166,192,172,184,172,198,107,227,100,230,164,166,166,165,165,233
durations:
  .byte 1,2,3,4,6,8,16
note_steps:
  .byte 0xdc, 0x02
  .byte 0x8c, 0x02
  .byte 0x25, 0x02
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  .byte 0x5c, 0x00
melody_data:
section_packed_000:
first_section:
  .byte 152
  .byte 86
  .byte 168
  .byte 149
  .byte 131
  .byte 89
  .byte 121
section_packed_002:
  .byte 185
  .byte 150
  .byte 201
section_packed_010:
  .byte 149
  .byte 255
section_packed_001:
  .byte 131
  .byte 89
  .byte 65
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  .byte 255
section_packed_004:
  .byte 0
  .byte 40
  .byte 48
  .byte 64
  .byte 255
section_packed_005:
  .byte 140
  .byte 72
  .byte 64
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  .byte 255
section_packed_006:
  .byte 174
  .byte 49
  .byte 1
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  .byte 255
section_packed_007:
  .byte 40
  .byte 48
  .byte 195
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  .byte 255
section_packed_008:
  .byte 56
  .byte 64
  .byte 197
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  .byte 255
section_packed_011:
  .byte 139
section_packed_009:
  .byte 0
  .byte 40
  .byte 48
  .byte 64
  .byte 206
  .byte 86
section_packed_019:
  .byte 232
  .byte 149
  .byte 131
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  .byte 255
section_packed_012:
  .byte 189
  .byte 149
  .byte 141
  .byte 255
section_packed_013:
  .byte 253
section_packed_022:
  .byte 142
section_packed_014:
  .byte 142
  .byte 142
  .byte 142
  .byte 142
  .byte 142
  .byte 255
section_packed_016:
  .byte 16
  .byte 241
  .byte 1
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  .byte 255
section_packed_017:
  .byte 105
  .byte 137
  .byte 113
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  .byte 240
section_packed_015:
  .byte 141
  .byte 139
  .byte 24
  .byte 96
  .byte 104
  .byte 255
section_packed_018:
  .byte 17
  .byte 137
  .byte 105
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  .byte 255
section_packed_020:
  .byte 253
  .byte 141
  .byte 255
section_packed_021:
  .byte 189
  .byte 142
  .byte 255
section_packed_023:
  .byte 254
  .byte 142
  .byte 142
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  .byte 141
section_packed_003:
  .byte 139
  .byte 255
music_data_end:
.balign 256
amplitude_gain:
  .byte 0,0,0,0,0,0,0,0,0,0,0,0,0,0,0,0
  .byte 254,254,254,254,255,255,255,255,0,0,0,0,1,1,1,1
  .byte 252,252,253,253,254,254,255,255,0,0,1,1,2,2,3,3
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  .byte 226,229,233,237,241,244,248,252,0,3,7,11,15,18,22,26

.balign 256
embedded_wave_bank:
  .byte 169,187,154,54,66,151,154,153,185,204,187,204,106,35,50,117
  .byte 104,68,84,168,204,204,139,117,104,68,84,168,204,204,139,117
  .byte 120,86,68,133,203,171,170,137,152,170,170,203,139,70,68,101
  .byte 169,172,154,54,66,167,153,153,184,205,170,220,107,19,49,134
