/* Generated by tools/build-attiny88-music.py. */
#include <avr/io.h>
.set BASE_COUNT, 35
.set STREAM_SECOND, 71
.section .text,"ax",@progbits
.global vectors
vectors:
  rjmp reset
  rjmp unused_irq
  rjmp unused_irq
  rjmp unused_irq
  rjmp unused_irq
  rjmp unused_irq
  rjmp unused_irq
  rjmp unused_irq
  rjmp unused_irq
  rjmp unused_irq
  rjmp unused_irq
  rjmp pwm_irq
  rjmp unused_irq
  rjmp unused_irq
  rjmp unused_irq
  rjmp unused_irq
  rjmp unused_irq
  rjmp unused_irq
  rjmp unused_irq
  rjmp unused_irq
unused_irq:
  rjmp reset
gain_finish:
  adc r17, r17
gain_return:
  ret
reset:
  /* ATtiny88: explicit stack, watchdog and board clock prescaler setup. */
  cli
  wdr
  ldi r16, 2
  out 62, r16
  ldi r16, 255
  out 61, r16
  clr r17
  out 52, r17
  lds r16, 96
  ori r16, 24
  sts 96, r16
  sts 96, r17
  ldi r16, 128
  sts 97, r16
  sts 97, r17
  sts 100, r17
  /* Clear interrupt sources left by the USB bootloader. */
  out _SFR_IO_ADDR(EIMSK), r17
  sts _SFR_MEM_ADDR(PCICR), r17
  sts _SFR_MEM_ADDR(TIMSK0), r17
  out _SFR_IO_ADDR(TCCR0A), r17
  sts _SFR_MEM_ADDR(ADCSRA), r17
  out _SFR_IO_ADDR(ACSR), r17
  ldi r16, 4
  out 42, r16
  ldi r16, 1
  out 43, r16
  ldi r27, 1
  clr r29
  ldi r31, 1
  ldi r30, 96
  ldi r18, 128
fill_ring:
  st Z+, r18
  cpi r30, 112
  brne fill_ring
  clr r16
clear_voices:
  st Z+, r16
  cpi r30, 152
  brne clear_voices
  clr r0
  clr r1
  clr r2
  clr r3
  clr r4
  clr r5
  clr r8
  clr r9
  clr r10
  clr r11
  clr r12
  clr r13
  clr r14
  clr r15
  ldi r16, 1
  mov r1, r16
  mov r9, r16
  ldi r16, STREAM_SECOND
  mov r8, r16
  mov r23, r18
  ldi r28, 96
  rcall music_step
  ldi r30, 110
  ldi r31, 1
  /* Fast PWM mode5, TOP255; high-byte TEMP remains zero. */
  clr r16
  sts 129, r16
  sts 111, r16
  sts 133, r16
  sts 132, r16
  sts 137, r16
  sts 139, r16
  sts 136, r18
  sts 138, r18
  ldi r16, 33
  sts 128, r16
  /* Configure OC1x before enabling the pin driver (doc8008, section 12.7.3). */
  sbi 4, 2

  ldi r16, 1
  out 22, r16
  sts 111, r16
  ldi r16, 9
  sts 129, r16
  sei
idle:
  mov r16, r30
  sub r16, r28
  andi r16, 15
  cpi r16, 13
  brcc idle
audio_step:
  in r16, 42
  subi r16, 3
  ldi r17, 0
  brcc tiny88_fraction_ready
  subi r16, 251
  ldi r17, 1
tiny88_fraction_ready:
  out 42, r16
  out 43, r17
  add r15, r17
  brcc render_sample
  mov r22, r30
  rcall music_tick
  mov r30, r22
  ldi r31, 1
render_sample:
  ldi r26, 112
  ldi r21, 240
voice_loop:
  ld r16, X+
  ld r17, X+
  ld r6, X+
  ld r7, X+
  add r16, r6
  adc r17, r7
  subi r26, 4
  st X+, r16
  st X+, r17
  subi r26, 254
  ldi r16, 0
  cpi r26, 121
  brcs guitar_bank
  ldi r16, 16
guitar_bank:
  mov r25, r7
  cpi r25, 2
  brne tiny88_register_decided
  mov r25, r6
  cpi r25, 102
tiny88_register_decided:
  brcs wave_register
  ori r16, 8
wave_register:
  swap r17
  andi r17, 15
  lsr r17
  or r16, r17
  movw r24, r30
  mov r30, r16
  ldi r31, hi8(embedded_wave_bank)
tiny88_flash_read_0:
  lpm r17, Z
  movw r30, r24
  brcc wave_nibble
  swap r17
wave_nibble:
  andi r17, 15
  add r21, r17
  cpi r26, 120
  brne rhythm_group
  mov r25, r4
  andi r25, 15
  rcall chord_gain
  mov r20, r17
  ldi r21, 208
rhythm_group:
  cpi r26, 144
  brne voice_loop
  mov r25, r5
  andi r25, 15
  rcall chord_gain
  asr r17
  add r17, r20
write_pwm:
  subi r17, 128
  add r23, r17
  ror r23
  st Z+, r23
  st Z+, r17
  andi r30, 111
  mov r23, r17
ring_published:
  rjmp idle
pwm_irq:
  sts 138, r18
ring_read:
  ldi r29, 1
  ld r18, Y+
  ldi r29, 0
  sbrc r28, 4
  ldi r28, 96
  reti
chord_gain:
  mov r16, r25
  movw r24, r30
  mov r31, r16
  lsr r31
  clr r30
  ror r30
  subi r21, 192
  add r30, r21
  ldi r16, hi8(chord_amplitude_gain)
  add r31, r16
  lpm r17, Z
  movw r30, r24
  ret
music_tick:
  inc r14
  mov r20, r4
  rcall envelope
  mov r4, r20
  mov r20, r5
  rcall envelope
  mov r5, r20
  mov r16, r1
  or r16, r9
  brne song_running
  mov r16, r4
  or r16, r5
  brne music_return
  tst r2
  brne pause_count
  ldi r16, 74
  mov r2, r16
pause_count:
  dec r2
  brne music_return
restart_song:
  clr r0
  ldi r16, 1
  mov r1, r16
  mov r9, r16
  ldi r16, STREAM_SECOND
  mov r8, r16
  clr r3
  clr r10
  clr r11
  clr r12
  clr r13
  rjmp music_step
song_running:
  ldi r16, 5
  add r12, r16
  ldi r16, 22
  adc r13, r16
  brcc music_return
music_step:
  movw r16, r0
  movw r24, r2
  mov r20, r4
  ldi r19, 0
  rcall part_tick
  movw r0, r16
  movw r2, r24
  mov r4, r20
  movw r16, r8
  movw r24, r10
  mov r20, r5
  ldi r19, 1
  rcall part_tick
  movw r8, r16
  movw r10, r24
  mov r5, r20
music_return:
  ret
envelope:
  mov r21, r20
  andi r21, 15
  breq envelope_return
  sbrs r20, 7
  rjmp envelope_decay
  ldi r25, 1
  cpi r21, 10
  brcc envelope_mask
  ldi r25, 3
  cpi r21, 7
  brcc envelope_mask
  ldi r25, 7
envelope_mask:
  and r25, r14
  brne envelope_return
envelope_decay:
  dec r20
envelope_return:
  ret
part_tick:
  tst r17
  breq part_return
  dec r17
  brne part_return
  sbrc r25, 7
  rjmp read_base
  andi r20, 127
next_symbol:
  tst r24
  breq read_stream
  dec r24
  mov r26, r24
  subi r26, 112
  sbrc r19, 0
  subi r26, 254
  ld r21, X+
  rjmp classify_symbol
read_stream:
  ldi r30, lo8(song_stream)
  ldi r31, hi8(song_stream)
  add r30, r16
  adc r31, r29
  lpm r21, Z
  inc r16
  cpi r21, 255
  breq part_return
classify_symbol:
  cpi r21, BASE_COUNT
  brcs symbol_base
  subi r21, BASE_COUNT
  lsl r21
  ldi r30, lo8(song_rules)
  ldi r31, hi8(song_rules)
  add r30, r21
  adc r31, r29
  lpm r6, Z+
  lpm r7, Z
  mov r26, r24
  subi r26, 112
  sbrc r19, 0
  subi r26, 254
  st X+, r7
  inc r24
  mov r21, r6
  rjmp classify_symbol
symbol_base:
  mov r25, r21
read_base:
  mov r21, r25
  andi r21, 127
  lsl r21
  ldi r30, lo8(song_bases)
  ldi r31, hi8(song_bases)
  add r30, r21
  adc r31, r29
  lpm r6, Z+
  lpm r7, Z
  sbrc r25, 7
  rjmp note_start
  mov r21, r7
  swap r21
  andi r21, 7
  ldi r30, lo8(song_gaps)
  ldi r31, hi8(song_gaps)
  add r30, r21
  adc r31, r29
  lpm r17, Z
  tst r17
  breq note_start
  ori r25, 128
part_return:
  ret
note_start:
  andi r25, 127
  mov r17, r7
  andi r17, 15
  ldi r20, 143
  ldi r30, lo8(song_shapes)
  ldi r31, hi8(song_shapes)
  add r30, r6
  adc r31, r29
  ldi r26, 112
  ldi r21, 2
  sbrc r19, 0
  ldi r26, 120
  sbrc r19, 0
  ldi r21, 6
load_chord:
  st X+, r29
  st X+, r29
  lpm r7, Z+
  st X+, r7
  lpm r7, Z+
  st X+, r7
  dec r21
  brne load_chord
chord_loaded:
  ret
song_shapes:
  .byte 0x0c, 0x04
  .byte 0x00, 0x00
  .byte 0x0c, 0x04
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  .byte 0x00, 0x00
song_bases:
.byte 0,1,4,1,4,17,8,17,12,1,16,19,20,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1
song_rules:
.byte 0,16,0,17,25,16,1,2,8,7,16,21,40,0,31,31,29,29,43,29,42,42,30,43,44,46,31,32,42,48,43,47,49,42,34,34,45,45,43,43,54,50
song_gaps:
.byte 0,1,2,24,7,6,20
song_stream:
.byte 0,38,1,3,38,4,3,38,4,5,6,7,7,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255

music_data_end:
.balign 256
chord_amplitude_gain:
  .byte 0,0,0,0,0,0,0,0,0,0,0,0,0,0,0,0
  .byte 0,0,0,0,0,0,0,0,0,0,0,0,0,0,0,0
  .byte 0,0,0,0,0,0,0,0,0,0,0,0,0,0,0,0
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  .byte 90,91,93,95,97,99,101,103,105,106,108,110,112,114,116,118

.balign 256
embedded_wave_bank:
  .byte 184,220,171,153,136,135,54,65,220,139,135,203,138,53,67,133
  .byte 168,204,171,153,136,120,70,83,152,186,138,69,68,134,203,155
  .byte 0,0,0,0,0,0,0,0,0,0,0,0,0,0,0,0
  .byte 0,0,0,0,0,0,0,0,0,0,0,0,0,0,0,0
