/* Generated by tools/build-attiny88-music.py. */
#include <avr/io.h>
.set GAIN_MINIMUM, 223
.set GRID_LOW, 251
.set GRID_HIGH, 13
.section .text,"ax",@progbits
.global vectors
vectors:
  rjmp reset
  rjmp unused_irq
  rjmp unused_irq
  rjmp unused_irq
  rjmp unused_irq
  rjmp unused_irq
  rjmp unused_irq
  rjmp unused_irq
  rjmp unused_irq
  rjmp unused_irq
  rjmp unused_irq
  rjmp pwm_irq
  rjmp unused_irq
  rjmp unused_irq
  rjmp unused_irq
  rjmp unused_irq
  rjmp unused_irq
  rjmp unused_irq
  rjmp unused_irq
  rjmp unused_irq
unused_irq:
  rjmp reset
  nop
  nop
reset:
  /* ATtiny88: explicit stack, watchdog and board clock prescaler setup. */
  cli
  wdr
  ldi r16, 2
  out 62, r16
  ldi r16, 255
  out 61, r16
  clr r17
  out 52, r17
  lds r16, 96
  ori r16, 24
  sts 96, r16
  sts 96, r17
  ldi r16, 128
  sts 97, r16
  sts 97, r17
  sts 100, r17
  /* Clear interrupt sources left by the USB bootloader. */
  out _SFR_IO_ADDR(EIMSK), r17
  sts _SFR_MEM_ADDR(PCICR), r17
  sts _SFR_MEM_ADDR(TIMSK0), r17
  out _SFR_IO_ADDR(TCCR0A), r17
  sts _SFR_MEM_ADDR(ADCSRA), r17
  out _SFR_IO_ADDR(ACSR), r17
  ldi r16, 4
  out 42, r16
  ldi r16, 1
  out 43, r16
  ldi r27, 1
  clr r29
  ldi r31, 1
  ldi r30, 96
  ldi r18, 128
fill_ring:
  st Z+, r18
  cpi r30, 112
  brne fill_ring
  clr r16
clear_states:
  st Z+, r16
  cpi r30, 140
  brne clear_states
  clr r4
  clr r5
  clr r8
  clr r9
  clr r10
  ldi r16, lo8(song_stream)
  mov r2, r16
  ldi r16, hi8(song_stream)
  mov r3, r16
  mov r23, r18
  ldi r28, 96
  rcall read_events
  ldi r30, 110
  ldi r31, 1
  /* Fast PWM mode5, TOP255; high-byte TEMP remains zero. */
  clr r16
  sts 129, r16
  sts 111, r16
  sts 133, r16
  sts 132, r16
  sts 137, r16
  sts 139, r16
  sts 136, r18
  sts 138, r18
  ldi r16, 33
  sts 128, r16
  /* Configure OC1x before enabling the pin driver (doc8008, section 12.7.3). */
  sbi 4, 2

  ldi r16, 1
  out 22, r16
  sts 111, r16
  ldi r16, 9
  sts 129, r16
  sei
idle:
  mov r16, r30
  sub r16, r28
  andi r16, 15
  cpi r16, 13
  brcc idle
audio_step:
  in r16, 42
  subi r16, 3
  ldi r17, 0
  brcc tiny88_fraction_ready
  subi r16, 251
  ldi r17, 1
tiny88_fraction_ready:
  out 42, r16
  out 43, r17
  add r10, r17
  brcc render_sample
  mov r14, r30
  rcall music_tick
  mov r30, r14
  ldi r31, 1
render_sample:
  ldi r26, 112
  clr r19
  clr r22
voice_loop:
  ld r20, X+
  ld r16, X+
  ld r17, X+
  ld r6, X+
  ld r7, X+
  add r16, r6
  adc r17, r7
  subi r26, 4
  st X+, r16
  st X+, r17
  subi r26, 254
  mov r16, r19
  mov r25, r7
  cpi r25, 2
  brne tiny88_register_decided
  mov r25, r6
  cpi r25, 102
tiny88_register_decided:
  brcs wave_register
  ori r16, 8
wave_register:
  swap r17
  andi r17, 15
  lsr r17
  or r16, r17
  movw r12, r30
  mov r30, r16
  ldi r31, hi8(embedded_wave_bank)
tiny88_flash_read_0:
  lpm r21, Z
  movw r30, r12
  brcc wave_nibble
  swap r21
wave_nibble:
  andi r21, 15
  subi r21, 8
  mov r25, r20
  andi r25, 15
  rcall voice_gain
  add r22, r17
  subi r19, 240
  cpi r26, 132
  brne voice_loop
master_gain:
  mov r12, r30
  ldi r30, lo8(output_gain)
  ldi r31, hi8(output_gain)
  subi r22, GAIN_MINIMUM
  add r30, r22
  adc r31, r29
  lpm r17, Z
  mov r30, r12
  ldi r31, 1
write_pwm:
  add r23, r17
  ror r23
  st Z+, r23
  st Z+, r17
  andi r30, 111
  mov r23, r17
ring_published:
  rjmp idle
pwm_irq:
  sts 138, r18
ring_read:
  ldi r29, 1
  ld r18, Y+
  ldi r29, 0
  sbrc r28, 4
  ldi r28, 96
  reti
voice_gain:
  clr r17
  ldi r24, 4
  lsr r25
gain_loop:
  brcc gain_no_add
  add r17, r21
gain_no_add:
  asr r17
  ror r25
  dec r24
  brne gain_loop
  lsl r25
  adc r17, r17
  ret
music_tick:
  ldi r26, 112
  ldi r30, lo8(part_levels)
  ldi r31, hi8(part_levels)
envelope_loop:
  ld r20, X+
  mov r21, r20
  andi r21, 15
  lpm r16, Z+
  sbrs r20, 7
  rjmp release_voice
  mov r25, r21
  sub r25, r16
  brcc store_envelope
  inc r20
  rjmp store_envelope
release_voice:
  tst r21
  breq store_envelope
  dec r20
store_envelope:
  subi r26, 1
  st X+, r20
  subi r26, 252
  cpi r26, 132
  brne envelope_loop
  ldi r16, GRID_LOW
  add r8, r16
  ldi r16, GRID_HIGH
  adc r9, r16
  brcc music_return
  dec r4
  brne music_return
read_events:
next_symbol:
  tst r5
  breq read_stream
  dec r5
  mov r26, r5
  subi r26, 124
  ld r21, X+
  rjmp classify_symbol
read_stream:
  movw r30, r2
  lpm r21, Z+
  movw r2, r30
  cpi r21, 255
  brne classify_symbol
restart_song:
  ldi r16, lo8(song_stream)
  mov r2, r16
  ldi r16, hi8(song_stream)
  mov r3, r16
  rjmp read_stream
classify_symbol:
  cpi r21, 192
  brcs event_leaf
  subi r21, 192
  lsl r21
  ldi r30, lo8(song_rules)
  ldi r31, hi8(song_rules)
  add r30, r21
  adc r31, r29
  lpm r6, Z+
  lpm r7, Z
  mov r26, r5
  subi r26, 124
  st X+, r7
  inc r5
  mov r21, r6
  rjmp classify_symbol
event_leaf:
  cpi r21, 128
  brcs note_event
  subi r21, 127
  mov r4, r21
music_return:
  ret
note_event:
  mov r16, r21
  lsr r16
  lsr r16
  lsr r16
  lsr r16
  lsr r16
  mov r26, r16
  lsl r26
  lsl r26
  add r26, r16
  subi r26, 144
  andi r21, 31
  brne note_on
note_off:
  ld r20, X+
  andi r20, 127
  subi r26, 1
  st X+, r20
note_released:
  rjmp next_symbol
note_on:
  ldi r20, 129
  st X+, r20
  subi r26, 254
  dec r21
  lsl r21
  ldi r30, lo8(pitch_steps)
  ldi r31, hi8(pitch_steps)
  add r30, r21
  adc r31, r29
  lpm r6, Z+
  lpm r7, Z
  st X+, r6
  st X+, r7
note_committed:
  rjmp next_symbol
part_levels:
.byte 15,12,11,10
pitch_steps:
  .byte 0xe7, 0x00
  .byte 0x03, 0x01
  .byte 0x12, 0x01
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  .byte 0xd0, 0x04
song_rules:
.byte 64,96,0,32,193,192,129,194,0,192,42,72,197,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226
song_stream:
.byte 201,206,47,74,102,202,18,204,103,195,19,45,72,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255
output_gain:
.byte 0,4,8,12,16,19,23,27,31,35,39,43,47,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244

music_data_end:

.balign 256
embedded_wave_bank:
  .byte 152,170,220,107,52,100,135,137,152,103,151,186,188,154,71,83
  .byte 165,220,141,101,102,184,140,35,134,186,235,222,72,67,84,118
  .byte 182,189,187,171,90,83,85,101,152,51,218,171,121,220,87,68
  .byte 152,86,118,151,186,220,123,67,168,89,83,135,169,170,154,120
