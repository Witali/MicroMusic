/* Generated by tools/build-attiny88-music.py. */
/* Stable native Alicia kernel. Page-carry ADCs are removed only after assembled-address proof. */
.section .text,"ax",@progbits
.global vectors
.set REST_INDEX, 20
.set HOLD_INDEX, 21
.set PLAYLIST_LEN, 13
.set FIRST_PLAYLIST_INDEX, 1
.set GRID_STEP_LOW, 135
.set GRID_STEP_HIGH, 54
.set GRID_INITIAL_HIGH, 202
.set BASS_BASE_NEGATIVE, 236
vectors:
  rjmp reset
  rjmp unused_irq
  rjmp unused_irq
  rjmp unused_irq
  rjmp unused_irq
  rjmp unused_irq
  rjmp unused_irq
  rjmp unused_irq
  rjmp unused_irq
  rjmp unused_irq
  rjmp unused_irq
  rjmp pwm_irq
  rjmp unused_irq
  rjmp unused_irq
  rjmp unused_irq
  rjmp unused_irq
  rjmp unused_irq
  rjmp unused_irq
  rjmp unused_irq
  rjmp unused_irq
unused_irq:
  rjmp reset
envelope_return:
  asr r17
  ret
reset:
  /* ATtiny88: explicit stack, watchdog and 8 MHz prescaler setup. */
  cli
  wdr
  ldi r16, 2
  out 62, r16
  ldi r16, 255
  out 61, r16
  clr r17
  out 52, r17
  lds r16, 96
  ori r16, 24
  sts 96, r16
  sts 96, r17
  ldi r16, 128
  sts 97, r16
  sts 97, r17
  sts 100, r17
  ldi r16, 4
  out 42, r16
  ldi r16, 1
  out 43, r16
  clr r29
  ldi r27, 1
  clr r2
  clr r15
  clr r24
  ldi r30, 97
  ldi r31, 1
clear_ram:
  st Z+, r29
  cpi r30, 144
  brne clear_ram
  ldi r18, 128
  ldi r30, 128
fill_ring:
  st Z+, r18
  cpi r30, 144
  brne fill_ring
  mov r23, r18
  ldi r28, 128
  ldi r22, 142
  ldi r16, FIRST_PLAYLIST_INDEX
  mov r4, r16
  clr r3
  ldi r30, lo8(first_section)
  ldi r31, hi8(first_section)
  rcall read_event
  /* Fast PWM mode5, TOP255; high-byte TEMP remains zero. */
  clr r16
  sts 129, r16
  sts 111, r16
  sts 133, r16
  sts 132, r16
  sts 137, r16
  sts 139, r16
  sts 136, r18
  sts 138, r18
  ldi r16, 33
  sts 128, r16
  /* Configure OC1x before enabling the pin driver (doc8008, section 12.7.3). */
  sbi 4, 2

  ldi r16, 1
  out 22, r16
  sts 111, r16
  ldi r16, 9
  sts 129, r16
  sei
idle:
  mov r16, r22
  sub r16, r28
  andi r16, 15
check_space:
  cpi r16, 13
  brcc idle
audio_step:
  in r16, 42
  subi r16, 1
  ldi r17, 1
  brcc tiny88_fraction_ready
  ldi r16, 4
  ldi r17, 2
tiny88_fraction_ready:
  out 42, r16
  out 43, r17
  add r15, r17
  brcc render_sample
  rcall music_tick
render_sample:
  ldi r26, 97
  clr r21
voice_loop:
  ld r25, X+
  ld r16, X+
  ld r17, X+
  ld r0, X+
  ld r6, X+
  add r16, r0
  adc r17, r6
  subi r26, 4
  st X+, r16
  st X+, r17
  subi r26, 254
  mov r16, r6
  rcall render_tone
  sbrc r26, 4
  asr r17
primary_gain:
  add r21, r17
  cpi r26, 127
  brne voice_loop
write_pwm:
  subi r21, 128
  mov r16, r23
  add r16, r21
  ror r16
  mov r26, r22
  st X+, r16
  st X+, r21
  mov r22, r26
  andi r22, 143
ring_published:
  mov r23, r21
  rjmp idle
pwm_irq:
  sts 138, r18
ring_read:
  ldi r29, 1
  ld r18, Y+
  ldi r29, 0
  sbrc r28, 4
  ldi r28, 128
irq_restore:
  reti
music_tick:
  inc r24
  ldi r26, 97
envelope_loop:
  ld r16, X+
  mov r17, r16
  andi r17, 15
  sbrs r16, 7
  rjmp state_release
  sbrc r16, 6
  rjmp state_plucked
  cpi r17, 9
  brcc envelope_store
  subi r16, 252
  rjmp envelope_store
state_plucked:
  tst r17
  breq envelope_store
  ldi r25, 15
  cpi r17, 7
  brcs state_mask
  ldi r25, 7
  cpi r17, 10
  brcs state_mask
  ldi r25, 3
state_mask:
  and r25, r24
  brne envelope_store
  dec r16
  rjmp envelope_store
state_release:
  tst r17
  breq envelope_store
  dec r16
  cpi r17, 1
  breq envelope_store
  sbrc r16, 6
  dec r16
envelope_store:

  subi r26, 1
  st X+, r16
  subi r26, 252
  cpi r26, 127
  brne envelope_loop
.L0a8:
  add r2, r8
  adc r3, r9
  brcs grid_step
  ret
grid_step:
  rcall accompaniment_tick
.L0ba:
  dec r1
  breq read_event
  ret
read_event:
  lpm r16, Z+
  cpi r16, 192
  brcs melodic_event
  cpi r16, 248
  brcs chord_event
  cpi r16, 251
  brcs tempo_event
  cpi r16, 253
  brcs instrument_event
  rjmp next_section
tempo_event:
  subi r16, 248
  lsl r16
  movw r12, r30
  ldi r30, lo8(tempo_steps)
  ldi r31, hi8(tempo_steps)
  add r30, r16
  adc r31, r29
  lpm r8, Z+
  lpm r9, Z
  movw r30, r12
  rjmp read_event
instrument_event:
  ldi r17, 206
  sbrc r16, 2
  ldi r17, 144
  mov r7, r17
  rjmp read_event
chord_event:
  subi r16, 192
  lsl r16
  movw r12, r30
  ldi r30, lo8(chord_descriptors)
  ldi r31, hi8(chord_descriptors)
  add r30, r16
  adc r31, r29
  lpm r5, Z+
  lpm r14, Z
  mov r19, r14
  swap r19
  andi r19, 15
  mov r17, r19
  lsl r19
  add r19, r17
  lsl r19
  mov r16, r14
  andi r16, 15
  subi r16, BASS_BASE_NEGATIVE
  ldi r26, 107
  ldi r25, 160
  rcall indexed_note
  mov r16, r5
  swap r16
  andi r16, 15
  ldi r26, 112
  ldi r25, 144
  rcall indexed_note
  ldi r20, 6
  rcall arpeggio_note
  rjmp read_event
arpeggio_note:
  mov r16, r5
  andi r16, 15
  swap r5
  ldi r26, 102
  ldi r25, 197
  rcall indexed_note
  movw r30, r12
  ret
melodic_event:
  /* Decode compact note/duration; load 16-bit DDS increment or signal lead release. */
  movw r12, r30
  mov r17, r16
  andi r17, 7
  ldi r30, lo8(durations)
  ldi r31, hi8(durations)
  add r30, r17
  adc r31, r29
  lpm r1, Z
  movw r30, r12
  /* BEGIN LEAD FREQUENCY */
  lsr r16
  lsr r16
  lsr r16
  cpi r16, REST_INDEX
  breq note_rest
  brcc hold_sample
  ldi r26, 97
  mov r25, r7
  rcall indexed_note
lead_commit:
  movw r30, r12
  rjmp hold_sample
note_rest:
release_lead:
  lds r17, 353
  andi r17, 127
  sts 353, r17
hold_sample:
  ret
next_section:
  /* Playlist contains direct section offsets: no second lookup table. */
  ldi r30, lo8(playlist)
  ldi r31, hi8(playlist)
  add r30, r4
  adc r31, r29
  lpm r16, Z
  inc r4
  mov r17, r4
  cpi r17, PLAYLIST_LEN
  brne .L15c
  clr r4
.L15c:
  ldi r30, lo8(melody_data)
  ldi r31, hi8(melody_data)
  add r30, r16
  adc r31, r29
  rjmp read_event
render_tone:
  cpi r16, 4
  brne tiny88_register_decided
  mov r16, r0
  cpi r16, 205
tiny88_register_decided:
  /* Choose a register-dependent 16-step sustain wavetable and apply its amplitude envelope. */
  mov r0, r25
  andi r25, 15
  breq voice_silent
  mov r16, r0
  andi r16, 48
  brcs .L216
  ori r16, 8
.L216:
  cpi r26, 102
  brne piano_attack_done
  cpi r25, 14
  brcs piano_attack_done
  ori r16, 48
piano_attack_done:
  swap r17
  andi r17, 15
  lsr r17
  or r16, r17
  out 33, r16
  sbi 31, 0
  in r17, 32
  brcc eeprom_low_nibble
  swap r17
eeprom_low_nibble:
  andi r17, 15
.L25c:
  movw r10, r30
  swap r25
  or r25, r17
  mov r30, r25
  ldi r31, hi8(amplitude_gain)
  lpm r17, Z
  movw r30, r10
  ret
voice_silent:
  clr r17
  rjmp envelope_return
initialize_voice:
  rcall capture_ram_tail
  subi r26, 1
  st X+, r25
  subi r26, 254
  lpm r16, Z+
  st X+, r16
  lpm r16, Z+
  st X+, r16
voice_initialized:
  ret
capture_ram_tail:
  movw r10, r30
  lds r16, 373
  andi r16, 15
  lds r17, 378
  andi r17, 15
  sub r16, r17
  ldi r30, 117
  brcs ram_tail_destination
  ldi r30, 122
ram_tail_destination:
  ld r16, X+
  andi r16, 127
  mov r17, r16
  andi r17, 15
  breq no_ram_tail
  ldi r31, 1
  st Z+, r16
  ldi r17, 4
ram_tail_copy:
  ld r0, X+
  st Z+, r0
  dec r17
  brne ram_tail_copy
  subi r26, 4
no_ram_tail:
  movw r30, r10
  rjmp envelope_return
indexed_note:
  lsl r16
  ldi r30, lo8(note_steps)
  ldi r31, hi8(note_steps)
  add r30, r16
  adc r31, r29
  rjmp initialize_voice
accompaniment_tick:
  tst r19
  breq accompaniment_return
  dec r19
  cpi r19, 1
  breq stop_accompaniment
  dec r20
  brne accompaniment_return
  ldi r20, 6
  movw r12, r30
  rcall arpeggio_note
accompaniment_return:
  ret
stop_accompaniment:
  clr r19
  ldi r26, 102
stop_companion_loop:
  ld r16, X+
  andi r16, 127
  subi r26, 1
  st X+, r16
  subi r26, 252
  cpi r26, 117
  brne stop_companion_loop
  ret
playlist:
  .byte 0,23,34,62,78,89,142,23,164,62,184,89,196
durations:
  .byte 3,4,6,12,18,24,30,36
tempo_steps:
  .byte 135,54
  .byte 140,40
  .byte 209,60
note_steps:
  .byte 0xdc, 0x02
  .byte 0x36, 0x03
  .byte 0x67, 0x03
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  .byte 0x06, 0x02
chord_descriptors:
  .byte 97,96
  .byte 98,99
  .byte 132,103
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  .byte 129,128
melody_data:
section_packed_000:
first_section:
  .byte 248
  .byte 251
  .byte 192
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  .byte 255
section_packed_001:
  .byte 92
  .byte 194
  .byte 162
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  .byte 255
section_packed_002:
  .byte 196
  .byte 164
  .byte 197
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  .byte 255
section_packed_003:
  .byte 162
  .byte 122
  .byte 106
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  .byte 255
section_packed_004:
  .byte 203
  .byte 151
  .byte 251
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  .byte 255
section_packed_005:
  .byte 249
  .byte 252
  .byte 204
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  .byte 255
section_packed_006:
  .byte 212
  .byte 90
  .byte 138
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  .byte 255
section_packed_007:
  .byte 192
  .byte 167
  .byte 193
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  .byte 255
section_packed_008:
  .byte 251
  .byte 203
  .byte 162
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  .byte 255
section_packed_009:
  .byte 209
  .byte 90
  .byte 138
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  .byte 255
music_data_end:
.balign 256
amplitude_gain:
  .byte 0,0,0,0,0,0,0,0,0,0,0,0,0,0,0,0
  .byte 254,254,254,254,255,255,255,255,0,0,0,0,1,1,1,1
  .byte 252,252,253,253,254,254,255,255,0,0,1,1,2,2,3,3
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  .byte 226,229,233,237,241,244,248,252,0,3,7,11,15,18,22,26
