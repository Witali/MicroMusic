/*
Copyright (c) 2003-2010, Mark Borgerding

All rights reserved.

Redistribution and use in source and binary forms, with or without modification,
are permitted provided that the following conditions are met:

    * Redistributions of source code must retain the above copyright notice,
this list of conditions and the following disclaimer.
    * Redistributions in binary form must reproduce the above copyright notice,
this list of conditions and the following disclaimer in the documentation and/or
other materials provided with the distribution.
    * Neither the author nor the names of any contributors may be used to
endorse or promote products derived from this software without specific prior
written permission.

THIS SOFTWARE IS PROVIDED BY THE COPYRIGHT HOLDERS AND CONTRIBUTORS "AS IS" AND
ANY EXPRESS OR IMPLIED WARRANTIES, INCLUDING, BUT NOT LIMITED TO, THE IMPLIED
WARRANTIES OF MERCHANTABILITY AND FITNESS FOR A PARTICULAR PURPOSE ARE
DISCLAIMED. IN NO EVENT SHALL THE COPYRIGHT OWNER OR CONTRIBUTORS BE LIABLE FOR
ANY DIRECT, INDIRECT, INCIDENTAL, SPECIAL, EXEMPLARY, OR CONSEQUENTIAL DAMAGES
(INCLUDING, BUT NOT LIMITED TO, PROCUREMENT OF SUBSTITUTE GOODS OR SERVICES;
LOSS OF USE, DATA, OR PROFITS; OR BUSINESS INTERRUPTION) HOWEVER CAUSED AND ON
ANY THEORY OF LIABILITY, WHETHER IN CONTRACT, STRICT LIABILITY, OR TORT
(INCLUDING NEGLIGENCE OR OTHERWISE) ARISING IN ANY WAY OUT OF THE USE OF THIS
SOFTWARE, EVEN IF ADVISED OF THE POSSIBILITY OF SUCH DAMAGE.
*/
/* Generated by tools/generate_compact_tables.py from pinned Codec2 1.2.0.
 * Exact original forward KISS twiddles and Parzen window, stored as C99 hex floats.
 * Window copyright David Rowe, LGPL-2.1; see vendor/codec2-1.2.0/src/sine.c.
 */
static const float compact_twiddle[512] CODEC2_TABLE_STORAGE = {
    0x1.0000000000000p+0f, -0x0.0p+0f, 0x1.ffd8860000000p-1f, -0x1.9215600000000p-6f,
    0x1.ff621e0000000p-1f, -0x1.91f6600000000p-5f, 0x1.fe9cda0000000p-1f, -0x1.2d520a0000000p-4f,
    0x1.fd88da0000000p-1f, -0x1.917a6c0000000p-4f, 0x1.fc26480000000p-1f, -0x1.f564e40000000p-4f,
    0x1.fa75580000000p-1f, -0x1.2c81060000000p-3f, 0x1.f876500000000p-1f, -0x1.5e21440000000p-3f,
    0x1.f6297c0000000p-1f, -0x1.8f8b840000000p-3f, 0x1.f38f3a0000000p-1f, -0x1.c0b8260000000p-3f,
    0x1.f0a7f00000000p-1f, -0x1.f19f980000000p-3f, 0x1.ed740e0000000p-1f, -0x1.111d260000000p-2f,
    0x1.e9f4160000000p-1f, -0x1.2940620000000p-2f, 0x1.e6288e0000000p-1f, -0x1.4135ca0000000p-2f,
    0x1.e212100000000p-1f, -0x1.58f9a60000000p-2f, 0x1.ddb13c0000000p-1f, -0x1.7088540000000p-2f,
    0x1.d906bc0000000p-1f, -0x1.87de2c0000000p-2f, 0x1.d4134e0000000p-1f, -0x1.9ef7940000000p-2f,
    0x1.ced7b00000000p-1f, -0x1.b5d1000000000p-2f, 0x1.c954b20000000p-1f, -0x1.cc66ea0000000p-2f,
    0x1.c38b300000000p-1f, -0x1.e2b5d20000000p-2f, 0x1.bd7c0c0000000p-1f, -0x1.f8ba4c0000000p-2f,
    0x1.b728340000000p-1f, -0x1.07387a0000000p-1f, 0x1.b090a60000000p-1f, -0x1.11eb360000000p-1f,
    0x1.a9b6620000000p-1f, -0x1.1c73b40000000p-1f, 0x1.a29a7a0000000p-1f, -0x1.26d0560000000p-1f,
    0x1.9b3e040000000p-1f, -0x1.30ff800000000p-1f, 0x1.93a2260000000p-1f, -0x1.3affa20000000p-1f,
    0x1.8bc8080000000p-1f, -0x1.44cf320000000p-1f, 0x1.83b0e00000000p-1f, -0x1.4e6cac0000000p-1f,
    0x1.7b5df20000000p-1f, -0x1.57d6940000000p-1f, 0x1.72d0840000000p-1f, -0x1.610b760000000p-1f,
    0x1.6a09e60000000p-1f, -0x1.6a09e60000000p-1f, 0x1.610b760000000p-1f, -0x1.72d0820000000p-1f,
    0x1.57d6940000000p-1f, -0x1.7b5df20000000p-1f, 0x1.4e6cac0000000p-1f, -0x1.83b0e00000000p-1f,
    0x1.44cf320000000p-1f, -0x1.8bc8060000000p-1f, 0x1.3affa20000000p-1f, -0x1.93a2240000000p-1f,
    0x1.30ff800000000p-1f, -0x1.9b3e040000000p-1f, 0x1.26d0560000000p-1f, -0x1.a29a7a0000000p-1f,
    0x1.1c73b40000000p-1f, -0x1.a9b6620000000p-1f, 0x1.11eb360000000p-1f, -0x1.b090a60000000p-1f,
    0x1.07387c0000000p-1f, -0x1.b728340000000p-1f, 0x1.f8ba4e0000000p-2f, -0x1.bd7c0a0000000p-1f,
    0x1.e2b5d60000000p-2f, -0x1.c38b2e0000000p-1f, 0x1.cc66e80000000p-2f, -0x1.c954b20000000p-1f,
    0x1.b5d1020000000p-2f, -0x1.ced7b00000000p-1f, 0x1.9ef7920000000p-2f, -0x1.d4134e0000000p-1f,
    0x1.87de2a0000000p-2f, -0x1.d906bc0000000p-1f, 0x1.7088560000000p-2f, -0x1.ddb13a0000000p-1f,
    0x1.58f9a60000000p-2f, -0x1.e212100000000p-1f, 0x1.4135ca0000000p-2f, -0x1.e6288e0000000p-1f,
    0x1.2940600000000p-2f, -0x1.e9f4160000000p-1f, 0x1.111d260000000p-2f, -0x1.ed740e0000000p-1f,
    0x1.f19fa00000000p-3f, -0x1.f0a7f00000000p-1f, 0x1.c0b8240000000p-3f, -0x1.f38f3a0000000p-1f,
    0x1.8f8b880000000p-3f, -0x1.f6297c0000000p-1f, 0x1.5e21400000000p-3f, -0x1.f876500000000p-1f,
    0x1.2c810a0000000p-3f, -0x1.fa75580000000p-1f, 0x1.f564d80000000p-4f, -0x1.fc26480000000p-1f,
    0x1.917a6a0000000p-4f, -0x1.fd88da0000000p-1f, 0x1.2d52160000000p-4f, -0x1.fe9cda0000000p-1f,
    0x1.91f6520000000p-5f, -0x1.ff621e0000000p-1f, 0x1.92157c0000000p-6f, -0x1.ffd8860000000p-1f,
    -0x1.777a5c0000000p-25f, -0x1.0000000000000p+0f, -0x1.92155a0000000p-6f, -0x1.ffd8860000000p-1f,
    -0x1.91f6420000000p-5f, -0x1.ff621e0000000p-1f, -0x1.2d520c0000000p-4f, -0x1.fe9cda0000000p-1f,
    -0x1.917a620000000p-4f, -0x1.fd88da0000000p-1f, -0x1.f564ee0000000p-4f, -0x1.fc26460000000p-1f,
    -0x1.2c81040000000p-3f, -0x1.fa75580000000p-1f, -0x1.5e214c0000000p-3f, -0x1.f876500000000p-1f,
    -0x1.8f8b840000000p-3f, -0x1.f6297c0000000p-1f, -0x1.c0b8200000000p-3f, -0x1.f38f3c0000000p-1f,
    -0x1.f19f9a0000000p-3f, -0x1.f0a7f00000000p-1f, -0x1.111d240000000p-2f, -0x1.ed740e0000000p-1f,
    -0x1.2940660000000p-2f, -0x1.e9f4140000000p-1f, -0x1.4135c80000000p-2f, -0x1.e6288e0000000p-1f,
    -0x1.58f9a40000000p-2f, -0x1.e212100000000p-1f, -0x1.7088540000000p-2f, -0x1.ddb13c0000000p-1f,
    -0x1.87de280000000p-2f, -0x1.d906be0000000p-1f, -0x1.9ef7960000000p-2f, -0x1.d4134c0000000p-1f,
    -0x1.b5d1000000000p-2f, -0x1.ced7b00000000p-1f, -0x1.cc66ec0000000p-2f, -0x1.c954b20000000p-1f,
    -0x1.e2b5cc0000000p-2f, -0x1.c38b300000000p-1f, -0x1.f8ba4c0000000p-2f, -0x1.bd7c0c0000000p-1f,
    -0x1.07387a0000000p-1f, -0x1.b728340000000p-1f, -0x1.11eb380000000p-1f, -0x1.b090a40000000p-1f,
    -0x1.1c73b20000000p-1f, -0x1.a9b6640000000p-1f, -0x1.26d0540000000p-1f, -0x1.a29a7a0000000p-1f,
    -0x1.30ff820000000p-1f, -0x1.9b3e040000000p-1f, -0x1.3affa00000000p-1f, -0x1.93a2260000000p-1f,
    -0x1.44cf320000000p-1f, -0x1.8bc8080000000p-1f, -0x1.4e6cac0000000p-1f, -0x1.83b0e00000000p-1f,
    -0x1.57d6960000000p-1f, -0x1.7b5df00000000p-1f, -0x1.610b740000000p-1f, -0x1.72d0840000000p-1f,
    -0x1.6a09e60000000p-1f, -0x1.6a09e60000000p-1f, -0x1.72d0860000000p-1f, -0x1.610b740000000p-1f,
    -0x1.7b5df00000000p-1f, -0x1.57d6960000000p-1f, -0x1.83b0e00000000p-1f, -0x1.4e6cac0000000p-1f,
    -0x1.8bc8080000000p-1f, -0x1.44cf320000000p-1f, -0x1.93a2260000000p-1f, -0x1.3affa00000000p-1f,
    -0x1.9b3e040000000p-1f, -0x1.30ff820000000p-1f, -0x1.a29a7a0000000p-1f, -0x1.26d0540000000p-1f,
    -0x1.a9b6640000000p-1f, -0x1.1c73b20000000p-1f, -0x1.b090a40000000p-1f, -0x1.11eb380000000p-1f,
    -0x1.b728340000000p-1f, -0x1.07387a0000000p-1f, -0x1.bd7c0c0000000p-1f, -0x1.f8ba4a0000000p-2f,
    -0x1.c38b2e0000000p-1f, -0x1.e2b5da0000000p-2f, -0x1.c954b20000000p-1f, -0x1.cc66ec0000000p-2f,
    -0x1.ced7b00000000p-1f, -0x1.b5d0fe0000000p-2f, -0x1.d4134e0000000p-1f, -0x1.9ef78e0000000p-2f,
    -0x1.d906bc0000000p-1f, -0x1.87de2e0000000p-2f, -0x1.ddb13c0000000p-1f, -0x1.7088540000000p-2f,
    -0x1.e212120000000p-1f, -0x1.58f9a40000000p-2f, -0x1.e6288e0000000p-1f, -0x1.4135d00000000p-2f,
    -0x1.e9f4160000000p-1f, -0x1.2940660000000p-2f, -0x1.ed740e0000000p-1f, -0x1.111d240000000p-2f,
    -0x1.f0a7f00000000p-1f, -0x1.f19f8a0000000p-3f, -0x1.f38f3a0000000p-1f, -0x1.c0b82e0000000p-3f,
    -0x1.f6297e0000000p-1f, -0x1.8f8b820000000p-3f, -0x1.f876500000000p-1f, -0x1.5e213a0000000p-3f,
    -0x1.fa75580000000p-1f, -0x1.2c81140000000p-3f, -0x1.fc26460000000p-1f, -0x1.f564ec0000000p-4f,
    -0x1.fd88da0000000p-1f, -0x1.917a600000000p-4f, -0x1.fe9cdc0000000p-1f, -0x1.2d51ea0000000p-4f,
    -0x1.ff621e0000000p-1f, -0x1.91f67a0000000p-5f, -0x1.ffd8860000000p-1f, -0x1.92154c0000000p-6f,
    -0x1.0000000000000p+0f, 0x1.777a5c0000000p-24f, -0x1.ffd8860000000p-1f, 0x1.9215080000000p-6f,
    -0x1.ff621e0000000p-1f, 0x1.91f6580000000p-5f, -0x1.fe9cda0000000p-1f, 0x1.2d52180000000p-4f,
    -0x1.fd88da0000000p-1f, 0x1.917a4e0000000p-4f, -0x1.fc26480000000p-1f, 0x1.f564da0000000p-4f,
    -0x1.fa75580000000p-1f, 0x1.2c810a0000000p-3f, -0x1.f876500000000p-1f, 0x1.5e21520000000p-3f,
    -0x1.f6297e0000000p-1f, 0x1.8f8b7a0000000p-3f, -0x1.f38f3a0000000p-1f, 0x1.c0b8260000000p-3f,
    -0x1.f0a7f00000000p-1f, 0x1.f19fa00000000p-3f, -0x1.ed74100000000p-1f, 0x1.111d200000000p-2f,
    -0x1.e9f4160000000p-1f, 0x1.2940600000000p-2f, -0x1.e6288e0000000p-1f, 0x1.4135cc0000000p-2f,
    -0x1.e212100000000p-1f, 0x1.58f9ae0000000p-2f, -0x1.ddb13c0000000p-1f, 0x1.7088500000000p-2f,
    -0x1.d906bc0000000p-1f, 0x1.87de2a0000000p-2f, -0x1.d4134c0000000p-1f, 0x1.9ef79a0000000p-2f,
    -0x1.ced7b00000000p-1f, 0x1.b5d0fc0000000p-2f, -0x1.c954b20000000p-1f, 0x1.cc66e80000000p-2f,
    -0x1.c38b2e0000000p-1f, 0x1.e2b5d60000000p-2f, -0x1.bd7c080000000p-1f, 0x1.f8ba540000000p-2f,
    -0x1.b728360000000p-1f, 0x1.0738780000000p-1f, -0x1.b090a60000000p-1f, 0x1.11eb360000000p-1f,
    -0x1.a9b6600000000p-1f, 0x1.1c73b60000000p-1f, -0x1.a29a7c0000000p-1f, 0x1.26d0520000000p-1f,
    -0x1.9b3e040000000p-1f, 0x1.30ff800000000p-1f, -0x1.93a2240000000p-1f, 0x1.3affa40000000p-1f,
    -0x1.8bc80a0000000p-1f, 0x1.44cf300000000p-1f, -0x1.83b0e20000000p-1f, 0x1.4e6caa0000000p-1f,
    -0x1.7b5df20000000p-1f, 0x1.57d6940000000p-1f, -0x1.72d0820000000p-1f, 0x1.610b780000000p-1f,
    -0x1.6a09e80000000p-1f, 0x1.6a09e40000000p-1f, -0x1.610b760000000p-1f, 0x1.72d0840000000p-1f,
    -0x1.57d6920000000p-1f, 0x1.7b5df40000000p-1f, -0x1.4e6cae0000000p-1f, 0x1.83b0de0000000p-1f,
    -0x1.44cf340000000p-1f, 0x1.8bc8060000000p-1f, -0x1.3affa20000000p-1f, 0x1.93a2260000000p-1f,
    -0x1.30ff7c0000000p-1f, 0x1.9b3e060000000p-1f, -0x1.26d0500000000p-1f, 0x1.a29a7e0000000p-1f,
    -0x1.1c73ba0000000p-1f, 0x1.a9b65e0000000p-1f, -0x1.11eb3a0000000p-1f, 0x1.b090a20000000p-1f,
    -0x1.07387c0000000p-1f, 0x1.b728320000000p-1f, -0x1.f8ba4e0000000p-2f, 0x1.bd7c0a0000000p-1f,
    -0x1.e2b5d00000000p-2f, 0x1.c38b300000000p-1f, -0x1.cc66e20000000p-2f, 0x1.c954b40000000p-1f,
    -0x1.b5d0f60000000p-2f, 0x1.ced7b20000000p-1f, -0x1.9ef7a20000000p-2f, 0x1.d4134a0000000p-1f,
    -0x1.87de340000000p-2f, 0x1.d906bc0000000p-1f, -0x1.7088580000000p-2f, 0x1.ddb13a0000000p-1f,
    -0x1.58f9a80000000p-2f, 0x1.e212100000000p-1f, -0x1.4135c60000000p-2f, 0x1.e628900000000p-1f,
    -0x1.29405a0000000p-2f, 0x1.e9f4160000000p-1f, -0x1.111d1a0000000p-2f, 0x1.ed74100000000p-1f,
    -0x1.f19fb20000000p-3f, 0x1.f0a7ee0000000p-1f, -0x1.c0b8380000000p-3f, 0x1.f38f3a0000000p-1f,
    -0x1.8f8b8c0000000p-3f, 0x1.f6297c0000000p-1f, -0x1.5e21440000000p-3f, 0x1.f876500000000p-1f,
    -0x1.2c80fe0000000p-3f, 0x1.fa75580000000p-1f, -0x1.f564c00000000p-4f, 0x1.fc26480000000p-1f,
    -0x1.917a340000000p-4f, 0x1.fd88da0000000p-1f, -0x1.2d523e0000000p-4f, 0x1.fe9cda0000000p-1f,
    -0x1.91f6a40000000p-5f, 0x1.ff621e0000000p-1f, -0x1.92159e0000000p-6f, 0x1.ffd8860000000p-1f,
    0x1.99bc5c0000000p-27f, 0x1.0000000000000p+0f, 0x1.9215b60000000p-6f, 0x1.ffd8860000000p-1f,
    0x1.91f6b00000000p-5f, 0x1.ff621e0000000p-1f, 0x1.2d52440000000p-4f, 0x1.fe9cda0000000p-1f,
    0x1.917a3a0000000p-4f, 0x1.fd88da0000000p-1f, 0x1.f564c60000000p-4f, 0x1.fc26480000000p-1f,
    0x1.2c81000000000p-3f, 0x1.fa75580000000p-1f, 0x1.5e21480000000p-3f, 0x1.f876500000000p-1f,
    0x1.8f8b900000000p-3f, 0x1.f6297c0000000p-1f, 0x1.c0b83c0000000p-3f, 0x1.f38f3a0000000p-1f,
    0x1.f19fb60000000p-3f, 0x1.f0a7ee0000000p-1f, 0x1.111d1a0000000p-2f, 0x1.ed74100000000p-1f,
    0x1.29405c0000000p-2f, 0x1.e9f4160000000p-1f, 0x1.4135c60000000p-2f, 0x1.e628900000000p-1f,
    0x1.58f9aa0000000p-2f, 0x1.e212100000000p-1f, 0x1.70885a0000000p-2f, 0x1.ddb13a0000000p-1f,
    0x1.87de360000000p-2f, 0x1.d906ba0000000p-1f, 0x1.9ef7860000000p-2f, 0x1.d413500000000p-1f,
    0x1.b5d0f60000000p-2f, 0x1.ced7b20000000p-1f, 0x1.cc66e40000000p-2f, 0x1.c954b40000000p-1f,
    0x1.e2b5d20000000p-2f, 0x1.c38b300000000p-1f, 0x1.f8ba500000000p-2f, 0x1.bd7c0a0000000p-1f,
    0x1.07387c0000000p-1f, 0x1.b728320000000p-1f, 0x1.11eb3a0000000p-1f, 0x1.b090a20000000p-1f,
    0x1.1c73ae0000000p-1f, 0x1.a9b6660000000p-1f, 0x1.26d0500000000p-1f, 0x1.a29a7e0000000p-1f,
    0x1.30ff7e0000000p-1f, 0x1.9b3e060000000p-1f, 0x1.3affa20000000p-1f, 0x1.93a2240000000p-1f,
    0x1.44cf340000000p-1f, 0x1.8bc8060000000p-1f, 0x1.4e6cae0000000p-1f, 0x1.83b0de0000000p-1f,
    0x1.57d6980000000p-1f, 0x1.7b5dee0000000p-1f, 0x1.610b700000000p-1f, 0x1.72d0880000000p-1f,
    0x1.6a09e40000000p-1f, 0x1.6a09ea0000000p-1f, 0x1.72d0820000000p-1f, 0x1.610b780000000p-1f,
    0x1.7b5df20000000p-1f, 0x1.57d6940000000p-1f, 0x1.83b0e20000000p-1f, 0x1.4e6caa0000000p-1f,
    0x1.8bc80a0000000p-1f, 0x1.44cf2e0000000p-1f, 0x1.93a2280000000p-1f, 0x1.3aff9e0000000p-1f,
    0x1.9b3e000000000p-1f, 0x1.30ff860000000p-1f, 0x1.a29a780000000p-1f, 0x1.26d0580000000p-1f,
    0x1.a9b6620000000p-1f, 0x1.1c73b60000000p-1f, 0x1.b090a60000000p-1f, 0x1.11eb360000000p-1f,
    0x1.b728360000000p-1f, 0x1.0738780000000p-1f, 0x1.bd7c0e0000000p-1f, 0x1.f8ba460000000p-2f,
    0x1.c38b320000000p-1f, 0x1.e2b5c60000000p-2f, 0x1.c954b00000000p-1f, 0x1.cc66f60000000p-2f,
    0x1.ced7ae0000000p-1f, 0x1.b5d1080000000p-2f, 0x1.d4134c0000000p-1f, 0x1.9ef7980000000p-2f,
    0x1.d906be0000000p-1f, 0x1.87de2a0000000p-2f, 0x1.ddb13c0000000p-1f, 0x1.70884e0000000p-2f,
    0x1.e212120000000p-1f, 0x1.58f99e0000000p-2f, 0x1.e628920000000p-1f, 0x1.4135bc0000000p-2f,
    0x1.e9f4140000000p-1f, 0x1.29406e0000000p-2f, 0x1.ed740e0000000p-1f, 0x1.111d2e0000000p-2f,
    0x1.f0a7f00000000p-1f, 0x1.f19f9e0000000p-3f, 0x1.f38f3a0000000p-1f, 0x1.c0b8240000000p-3f,
    0x1.f6297e0000000p-1f, 0x1.8f8b780000000p-3f, 0x1.f876500000000p-1f, 0x1.5e212e0000000p-3f,
    0x1.fa755a0000000p-1f, 0x1.2c80e80000000p-3f, 0x1.fc26460000000p-1f, 0x1.f565140000000p-4f,
    0x1.fd88da0000000p-1f, 0x1.917a880000000p-4f, 0x1.fe9cda0000000p-1f, 0x1.2d52120000000p-4f,
    0x1.ff621e0000000p-1f, 0x1.91f64c0000000p-5f, 0x1.ffd8860000000p-1f, 0x1.9214ee0000000p-6f,
};
static const float compact_super[256] CODEC2_TABLE_STORAGE = {
    -0x1.921cc80000000p-7f, -0x1.fff6220000000p-1f, -0x1.92155a0000000p-6f, -0x1.ffd8860000000p-1f,
    -0x1.2d86660000000p-5f, -0x1.ffa72e0000000p-1f, -0x1.91f6420000000p-5f, -0x1.ff621e0000000p-1f,
    -0x1.f656dc0000000p-5f, -0x1.ff09560000000p-1f, -0x1.2d520c0000000p-4f, -0x1.fe9cda0000000p-1f,
    -0x1.5f6d0e0000000p-4f, -0x1.fe1cb00000000p-1f, -0x1.917a620000000p-4f, -0x1.fd88da0000000p-1f,
    -0x1.c3785c0000000p-4f, -0x1.fce1600000000p-1f, -0x1.f564ee0000000p-4f, -0x1.fc26460000000p-1f,
    -0x1.139f060000000p-3f, -0x1.fb57980000000p-1f, -0x1.2c81040000000p-3f, -0x1.fa75580000000p-1f,
    -0x1.45576e0000000p-3f, -0x1.f97f920000000p-1f, -0x1.5e214c0000000p-3f, -0x1.f876500000000p-1f,
    -0x1.76dd9a0000000p-3f, -0x1.f7599a0000000p-1f, -0x1.8f8b840000000p-3f, -0x1.f6297c0000000p-1f,
    -0x1.a82a080000000p-3f, -0x1.f4e6040000000p-1f, -0x1.c0b8200000000p-3f, -0x1.f38f3c0000000p-1f,
    -0x1.d934fc0000000p-3f, -0x1.f225300000000p-1f, -0x1.f19f9a0000000p-3f, -0x1.f0a7f00000000p-1f,
    -0x1.04fb840000000p-2f, -0x1.ef178a0000000p-1f, -0x1.111d240000000p-2f, -0x1.ed740e0000000p-1f,
    -0x1.1d34440000000p-2f, -0x1.ebbd8c0000000p-1f, -0x1.2940660000000p-2f, -0x1.e9f4140000000p-1f,
    -0x1.35410a0000000p-2f, -0x1.e817bc0000000p-1f, -0x1.4135c80000000p-2f, -0x1.e6288e0000000p-1f,
    -0x1.4d1e260000000p-2f, -0x1.e426a40000000p-1f, -0x1.58f9a40000000p-2f, -0x1.e212100000000p-1f,
    -0x1.64c7dc0000000p-2f, -0x1.dfeae60000000p-1f, -0x1.7088540000000p-2f, -0x1.ddb13c0000000p-1f,
    -0x1.7c3a960000000p-2f, -0x1.db65260000000p-1f, -0x1.87de280000000p-2f, -0x1.d906be0000000p-1f,
    -0x1.9372a60000000p-2f, -0x1.d696180000000p-1f, -0x1.9ef7960000000p-2f, -0x1.d4134c0000000p-1f,
    -0x1.aa6c800000000p-2f, -0x1.d17e780000000p-1f, -0x1.b5d1000000000p-2f, -0x1.ced7b00000000p-1f,
    -0x1.c1249e0000000p-2f, -0x1.cc1f0e0000000p-1f, -0x1.cc66ec0000000p-2f, -0x1.c954b20000000p-1f,
    -0x1.d7977c0000000p-2f, -0x1.c678b20000000p-1f, -0x1.e2b5cc0000000p-2f, -0x1.c38b300000000p-1f,
    -0x1.edc1900000000p-2f, -0x1.c08c440000000p-1f, -0x1.f8ba4c0000000p-2f, -0x1.bd7c0c0000000p-1f,
    -0x1.01cfc80000000p-1f, -0x1.ba5aa60000000p-1f, -0x1.07387a0000000p-1f, -0x1.b728340000000p-1f,
    -0x1.0c97060000000p-1f, -0x1.b3e4d20000000p-1f, -0x1.11eb380000000p-1f, -0x1.b090a40000000p-1f,
    -0x1.1734d40000000p-1f, -0x1.ad2bcc0000000p-1f, -0x1.1c73b20000000p-1f, -0x1.a9b6640000000p-1f,
    -0x1.21a7980000000p-1f, -0x1.a630920000000p-1f, -0x1.26d0540000000p-1f, -0x1.a29a7a0000000p-1f,
    -0x1.2bedb40000000p-1f, -0x1.9ef43e0000000p-1f, -0x1.30ff820000000p-1f, -0x1.9b3e040000000p-1f,
    -0x1.36058e0000000p-1f, -0x1.9777ee0000000p-1f, -0x1.3affa00000000p-1f, -0x1.93a2260000000p-1f,
    -0x1.3fed940000000p-1f, -0x1.8fbccc0000000p-1f, -0x1.44cf320000000p-1f, -0x1.8bc8080000000p-1f,
    -0x1.49a44a0000000p-1f, -0x1.87c4000000000p-1f, -0x1.4e6cac0000000p-1f, -0x1.83b0e00000000p-1f,
    -0x1.53282a0000000p-1f, -0x1.7f8ecc0000000p-1f, -0x1.57d6960000000p-1f, -0x1.7b5df00000000p-1f,
    -0x1.5c77ba0000000p-1f, -0x1.771e780000000p-1f, -0x1.610b740000000p-1f, -0x1.72d0840000000p-1f,
    -0x1.6591920000000p-1f, -0x1.6e74460000000p-1f, -0x1.6a09e60000000p-1f, -0x1.6a09e60000000p-1f,
    -0x1.6e74460000000p-1f, -0x1.6591920000000p-1f, -0x1.72d0860000000p-1f, -0x1.610b740000000p-1f,
    -0x1.771e780000000p-1f, -0x1.5c77ba0000000p-1f, -0x1.7b5df00000000p-1f, -0x1.57d6960000000p-1f,
    -0x1.7f8ecc0000000p-1f, -0x1.53282a0000000p-1f, -0x1.83b0e00000000p-1f, -0x1.4e6cac0000000p-1f,
    -0x1.87c4020000000p-1f, -0x1.49a44a0000000p-1f, -0x1.8bc8080000000p-1f, -0x1.44cf320000000p-1f,
    -0x1.8fbccc0000000p-1f, -0x1.3fed940000000p-1f, -0x1.93a2260000000p-1f, -0x1.3affa00000000p-1f,
    -0x1.9777ee0000000p-1f, -0x1.36058e0000000p-1f, -0x1.9b3e040000000p-1f, -0x1.30ff820000000p-1f,
    -0x1.9ef43e0000000p-1f, -0x1.2bedb20000000p-1f, -0x1.a29a7a0000000p-1f, -0x1.26d0540000000p-1f,
    -0x1.a630920000000p-1f, -0x1.21a7980000000p-1f, -0x1.a9b6640000000p-1f, -0x1.1c73b20000000p-1f,
    -0x1.ad2bc80000000p-1f, -0x1.1734da0000000p-1f, -0x1.b090a40000000p-1f, -0x1.11eb380000000p-1f,
    -0x1.b3e4d40000000p-1f, -0x1.0c97060000000p-1f, -0x1.b728340000000p-1f, -0x1.07387a0000000p-1f,
    -0x1.ba5aa60000000p-1f, -0x1.01cfc80000000p-1f, -0x1.bd7c0c0000000p-1f, -0x1.f8ba4a0000000p-2f,
    -0x1.c08c440000000p-1f, -0x1.edc1900000000p-2f, -0x1.c38b2e0000000p-1f, -0x1.e2b5da0000000p-2f,
    -0x1.c678b20000000p-1f, -0x1.d7977a0000000p-2f, -0x1.c954b20000000p-1f, -0x1.cc66ec0000000p-2f,
    -0x1.cc1f100000000p-1f, -0x1.c1249e0000000p-2f, -0x1.ced7b00000000p-1f, -0x1.b5d0fe0000000p-2f,
    -0x1.d17e780000000p-1f, -0x1.aa6c7e0000000p-2f, -0x1.d4134e0000000p-1f, -0x1.9ef78e0000000p-2f,
    -0x1.d696160000000p-1f, -0x1.9372ac0000000p-2f, -0x1.d906bc0000000p-1f, -0x1.87de2e0000000p-2f,
    -0x1.db65260000000p-1f, -0x1.7c3a960000000p-2f, -0x1.ddb13c0000000p-1f, -0x1.7088540000000p-2f,
    -0x1.dfeae60000000p-1f, -0x1.64c7dc0000000p-2f, -0x1.e212120000000p-1f, -0x1.58f9a40000000p-2f,
    -0x1.e426a60000000p-1f, -0x1.4d1e1e0000000p-2f, -0x1.e6288e0000000p-1f, -0x1.4135d00000000p-2f,
    -0x1.e817ba0000000p-1f, -0x1.3541100000000p-2f, -0x1.e9f4160000000p-1f, -0x1.2940660000000p-2f,
    -0x1.ebbd8c0000000p-1f, -0x1.1d34440000000p-2f, -0x1.ed740e0000000p-1f, -0x1.111d240000000p-2f,
    -0x1.ef178a0000000p-1f, -0x1.04fb7c0000000p-2f, -0x1.f0a7f00000000p-1f, -0x1.f19f8a0000000p-3f,
    -0x1.f2252e0000000p-1f, -0x1.d9350a0000000p-3f, -0x1.f38f3a0000000p-1f, -0x1.c0b82e0000000p-3f,
    -0x1.f4e6040000000p-1f, -0x1.a82a060000000p-3f, -0x1.f6297e0000000p-1f, -0x1.8f8b820000000p-3f,
    -0x1.f7599a0000000p-1f, -0x1.76dd980000000p-3f, -0x1.f876500000000p-1f, -0x1.5e213a0000000p-3f,
    -0x1.f97f920000000p-1f, -0x1.45575c0000000p-3f, -0x1.fa75580000000p-1f, -0x1.2c81140000000p-3f,
    -0x1.fb57960000000p-1f, -0x1.139f140000000p-3f, -0x1.fc26460000000p-1f, -0x1.f564ec0000000p-4f,
    -0x1.fce1600000000p-1f, -0x1.c3785a0000000p-4f, -0x1.fd88da0000000p-1f, -0x1.917a600000000p-4f,
    -0x1.fe1cb00000000p-1f, -0x1.5f6cea0000000p-4f, -0x1.fe9cdc0000000p-1f, -0x1.2d51ea0000000p-4f,
    -0x1.ff09560000000p-1f, -0x1.f657160000000p-5f, -0x1.ff621e0000000p-1f, -0x1.91f67a0000000p-5f,
    -0x1.ffa72e0000000p-1f, -0x1.2d86600000000p-5f, -0x1.ffd8860000000p-1f, -0x1.92154c0000000p-6f,
    -0x1.fff6220000000p-1f, -0x1.921cae0000000p-7f, -0x1.0000000000000p+0f, 0x1.777a5c0000000p-24f,
};
static const float compact_window[160] CODEC2_TABLE_STORAGE = {
    0x0.0p+0f, 0x1.99999a0000000p-7f, 0x1.99999a0000000p-6f, 0x1.3333340000000p-5f,
    0x1.99999a0000000p-5f, 0x1.0000000000000p-4f, 0x1.3333340000000p-4f, 0x1.6666680000000p-4f,
    0x1.99999c0000000p-4f, 0x1.ccccd00000000p-4f, 0x1.0000020000000p-3f, 0x1.19999c0000000p-3f,
    0x1.3333360000000p-3f, 0x1.4cccd00000000p-3f, 0x1.66666a0000000p-3f, 0x1.8000040000000p-3f,
    0x1.99999e0000000p-3f, 0x1.b333380000000p-3f, 0x1.ccccd20000000p-3f, 0x1.e6666c0000000p-3f,
    0x1.0000020000000p-2f, 0x1.0cccce0000000p-2f, 0x1.19999a0000000p-2f, 0x1.2666660000000p-2f,
    0x1.3333320000000p-2f, 0x1.3ffffe0000000p-2f, 0x1.4cccca0000000p-2f, 0x1.5999960000000p-2f,
    0x1.6666620000000p-2f, 0x1.73332e0000000p-2f, 0x1.7ffffa0000000p-2f, 0x1.8cccc60000000p-2f,
    0x1.9999920000000p-2f, 0x1.a6665e0000000p-2f, 0x1.b3332a0000000p-2f, 0x1.bffff60000000p-2f,
    0x1.ccccc20000000p-2f, 0x1.d9998e0000000p-2f, 0x1.e6665a0000000p-2f, 0x1.f333260000000p-2f,
    0x1.fffff20000000p-2f, 0x1.0666600000000p-1f, 0x1.0cccc60000000p-1f, 0x1.13332c0000000p-1f,
    0x1.1999920000000p-1f, 0x1.1ffff80000000p-1f, 0x1.26665e0000000p-1f, 0x1.2cccc40000000p-1f,
    0x1.33332a0000000p-1f, 0x1.3999900000000p-1f, 0x1.3ffff60000000p-1f, 0x1.46665c0000000p-1f,
    0x1.4cccc20000000p-1f, 0x1.5333280000000p-1f, 0x1.59998e0000000p-1f, 0x1.5ffff40000000p-1f,
    0x1.66665a0000000p-1f, 0x1.6cccc00000000p-1f, 0x1.7333260000000p-1f, 0x1.79998c0000000p-1f,
    0x1.7ffff20000000p-1f, 0x1.8666580000000p-1f, 0x1.8cccbe0000000p-1f, 0x1.9333240000000p-1f,
    0x1.99998a0000000p-1f, 0x1.9ffff00000000p-1f, 0x1.a666560000000p-1f, 0x1.acccbc0000000p-1f,
    0x1.b333220000000p-1f, 0x1.b999880000000p-1f, 0x1.bfffee0000000p-1f, 0x1.c666540000000p-1f,
    0x1.ccccba0000000p-1f, 0x1.d333200000000p-1f, 0x1.d999860000000p-1f, 0x1.dfffec0000000p-1f,
    0x1.e666520000000p-1f, 0x1.ecccb80000000p-1f, 0x1.f3331e0000000p-1f, 0x1.f999840000000p-1f,
    0x1.0000000000000p+0f, 0x1.f9999a0000000p-1f, 0x1.f333340000000p-1f, 0x1.ecccce0000000p-1f,
    0x1.e666680000000p-1f, 0x1.e000020000000p-1f, 0x1.d9999c0000000p-1f, 0x1.d333360000000p-1f,
    0x1.ccccd00000000p-1f, 0x1.c6666a0000000p-1f, 0x1.c000040000000p-1f, 0x1.b9999e0000000p-1f,
    0x1.b333380000000p-1f, 0x1.acccd20000000p-1f, 0x1.a6666c0000000p-1f, 0x1.a000060000000p-1f,
    0x1.9999a00000000p-1f, 0x1.93333a0000000p-1f, 0x1.8cccd40000000p-1f, 0x1.86666e0000000p-1f,
    0x1.8000080000000p-1f, 0x1.7999a20000000p-1f, 0x1.73333c0000000p-1f, 0x1.6cccd60000000p-1f,
    0x1.6666700000000p-1f, 0x1.60000a0000000p-1f, 0x1.5999a40000000p-1f, 0x1.53333e0000000p-1f,
    0x1.4cccd80000000p-1f, 0x1.4666720000000p-1f, 0x1.40000c0000000p-1f, 0x1.3999a60000000p-1f,
    0x1.3333400000000p-1f, 0x1.2cccda0000000p-1f, 0x1.2666740000000p-1f, 0x1.20000e0000000p-1f,
    0x1.1999a80000000p-1f, 0x1.1333420000000p-1f, 0x1.0cccdc0000000p-1f, 0x1.0666760000000p-1f,
    0x1.0000100000000p-1f, 0x1.f333540000000p-2f, 0x1.e666880000000p-2f, 0x1.d999bc0000000p-2f,
    0x1.ccccf00000000p-2f, 0x1.c000240000000p-2f, 0x1.b333580000000p-2f, 0x1.a6668c0000000p-2f,
    0x1.9999c00000000p-2f, 0x1.8cccf40000000p-2f, 0x1.8000280000000p-2f, 0x1.73335c0000000p-2f,
    0x1.6666900000000p-2f, 0x1.5999c40000000p-2f, 0x1.4cccf80000000p-2f, 0x1.40002c0000000p-2f,
    0x1.3333600000000p-2f, 0x1.2666940000000p-2f, 0x1.1999c80000000p-2f, 0x1.0cccfc0000000p-2f,
    0x1.0000300000000p-2f, 0x1.e666c60000000p-3f, 0x1.cccd2c0000000p-3f, 0x1.b333920000000p-3f,
    0x1.9999f80000000p-3f, 0x1.80005e0000000p-3f, 0x1.6666c40000000p-3f, 0x1.4ccd2a0000000p-3f,
    0x1.3333900000000p-3f, 0x1.1999f60000000p-3f, 0x1.00005c0000000p-3f, 0x1.cccd840000000p-4f,
    0x1.999a500000000p-4f, 0x1.66671c0000000p-4f, 0x1.3333e80000000p-4f, 0x1.0000b40000000p-4f,
    0x1.999b020000000p-5f, 0x1.33349c0000000p-5f, 0x1.999c6c0000000p-6f, 0x1.999f3e0000000p-7f,
};
