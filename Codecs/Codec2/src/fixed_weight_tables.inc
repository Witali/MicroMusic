/*
Copyright (c) 2003-2010, Mark Borgerding

All rights reserved.

Redistribution and use in source and binary forms, with or without modification,
are permitted provided that the following conditions are met:

    * Redistributions of source code must retain the above copyright notice,
this list of conditions and the following disclaimer.
    * Redistributions in binary form must reproduce the above copyright notice,
this list of conditions and the following disclaimer in the documentation and/or
other materials provided with the distribution.
    * Neither the author nor the names of any contributors may be used to
endorse or promote products derived from this software without specific prior
written permission.

THIS SOFTWARE IS PROVIDED BY THE COPYRIGHT HOLDERS AND CONTRIBUTORS "AS IS" AND
ANY EXPRESS OR IMPLIED WARRANTIES, INCLUDING, BUT NOT LIMITED TO, THE IMPLIED
WARRANTIES OF MERCHANTABILITY AND FITNESS FOR A PARTICULAR PURPOSE ARE
DISCLAIMED. IN NO EVENT SHALL THE COPYRIGHT OWNER OR CONTRIBUTORS BE LIABLE FOR
ANY DIRECT, INDIRECT, INCIDENTAL, SPECIAL, EXEMPLARY, OR CONSEQUENTIAL DAMAGES
(INCLUDING, BUT NOT LIMITED TO, PROCUREMENT OF SUBSTITUTE GOODS OR SERVICES;
LOSS OF USE, DATA, OR PROFITS; OR BUSINESS INTERRUPTION) HOWEVER CAUSED AND ON
ANY THEORY OF LIABILITY, WHETHER IN CONTRACT, STRICT LIABILITY, OR TORT
(INCLUDING NEGLIGENCE OR OTHERWISE) ARISING IN ANY WAY OUT OF THE USE OF THIS
SOFTWARE, EVEN IF ADVISED OF THE POSSIBILITY OF SUCH DAMAGE.
*/
/* Quantized pinned binary32 KISS twiddles; forward direction. */
#if CODEC2_WEIGHT_TWIDDLE_Q == 14
static const int16_t weight_twiddle[512] CODEC2_TABLE_STORAGE = {
    16384, 0, 16379, -402, 16364, -804, 16340, -1205,
    16305, -1606, 16261, -2006, 16207, -2404, 16143, -2801,
    16069, -3196, 15986, -3590, 15893, -3981, 15791, -4370,
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    16305, 1606, 16340, 1205, 16364, 804, 16379, 402,
};
static const int16_t weight_super[256] CODEC2_TABLE_STORAGE = {
    -201, -16383, -402, -16379, -603, -16373, -804, -16364,
    -1005, -16353, -1205, -16340, -1406, -16324, -1606, -16305,
    -1806, -16284, -2006, -16261, -2205, -16235, -2404, -16207,
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    -16373, -603, -16379, -402, -16383, -201, -16384, 0,
};
#endif
#if CODEC2_WEIGHT_TWIDDLE_Q == 22
static const int32_t weight_twiddle[512] CODEC2_TABLE_STORAGE = {
    4194304, 0, 4193041, -102933, 4189252, -205805, 4182939, -308552,
    4174107, -411114, 4162761, -513428, 4148907, -615432, 4132554, -717066,
    4113712, -818268, 4092391, -918977, 4068606, -1019133, 4042370, -1118674,
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    4174107, 411114, 4182939, 308552, 4189252, 205805, 4193041, 102933,
};
static const int32_t weight_super[256] CODEC2_TABLE_STORAGE = {
    -51470, -4193988, -102933, -4193041, -154381, -4191462, -205805, -4189252,
    -257198, -4186411, -308552, -4182939, -359860, -4178838, -411114, -4174107,
    -462305, -4168748, -513428, -4162761, -564472, -4156147, -615432, -4148907,
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    -4191462, -154381, -4193041, -102933, -4193988, -51470, -4194304, 0,
};
#endif
#if CODEC2_WEIGHT_TWIDDLE_Q == 30
static const int32_t weight_twiddle[512] CODEC2_TABLE_STORAGE = {
    1073741824, 0, 1073418432, -26350944, 1072448448, -52686016, 1070832448, -78989352,
    1068571456, -105245104, 1065666816, -131437456, 1062120192, -157550640, 1057933824, -183568928,
    1053110144, -209476640, 1047652160, -235258160, 1041563136, -260897984, 1034846656, -286380640,
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    1068571456, 105245216, 1070832448, 78989384, 1072448448, 52685976, 1073418432, 26350830,
};
static const int32_t weight_super[256] CODEC2_TABLE_STORAGE = {
    -13176420, -1073660992, -26350938, -1073418432, -39521484, -1073014208, -52685956, -1072448448,
    -65842616, -1071721152, -78989360, -1070832448, -92124216, -1069782528, -105245064, -1068571456,
    -118350192, -1067199488, -131437496, -1065666752, -144504880, -1063973632, -157550624, -1062120192,
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    -1073014208, -39521472, -1073418432, -26350924, -1073660992, -13176407, -1073741824, 94,
};
#endif
