/* GENERATED FROM score.json BY score_compiler.py. */
playlist:
  .byte 0x00, 0x01, 0x02, 0x03, 0x03, 0x04, 0x03, 0x03, 0x05, 0x05, 0x04, 0x03, 0x03, 0x05, 0x05   /* playlist section indices (no sentinel) */
durations:
  .byte 0x0e, 0x1b, 0x29, 0x37, 0x52, 0x6e, 0xdc   /* ticks @ 80 BPM, 512 PWM periods/tick */
note_steps:
  .byte 0x40, 0x02   /* E3, 329.6 Hz */
  .byte 0x87, 0x02   /* F#3, 370.2 Hz */
  .byte 0xad, 0x02   /* G3, 392.0 Hz */
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  .byte 0x05, 0x08   /* D5, 1174.7 Hz */
chord_steps:
  .byte 0x5f, 0x03, 0x87, 0x02   /* Bm: piano B3, guitar F#3 */
  .byte 0xad, 0x02, 0x01, 0x02   /* Gmaj7: piano G3, guitar D3 */
  .byte 0x40, 0x02, 0xb0, 0x01   /* Em: piano E3, guitar B2 */
  .byte 0x87, 0x02, 0xe4, 0x01   /* F#m: piano F#3, guitar C#3 */
  .byte 0xe4, 0x01, 0x6b, 0x01   /* C#m7b5: piano C#3, guitar G#2 */
section_offsets:
  .byte 0x00, 0x15, 0x51, 0x90, 0xb3, 0xe5   /* byte offsets in melody_data */
melody_data:
section_intro:
  .byte 0xe0, 0x19, 0x39, 0x61, 0x40, 0x50, 0xe1, 0x11, 0x39, 0x5b, 0xe2, 0x01, 0x31, 0x51, 0x40, 0x50
  .byte 0xe3, 0x09, 0x31, 0x5b, 0xff
section_A:
  .byte 0xe0, 0x2d, 0xe1, 0x1b, 0x2a, 0x20, 0xe2, 0x34, 0x29, 0xe3, 0x3d, 0xe0, 0x2b, 0x33, 0xe1, 0x3b
  .byte 0x33, 0xe2, 0x33, 0x2a, 0x30, 0xe3, 0x25, 0xe0, 0x2b, 0x19, 0x41, 0xe1, 0x41, 0x39, 0x39, 0x40
  .byte 0x38, 0xe2, 0x33, 0x29, 0x31, 0xe3, 0x31, 0x41, 0x39, 0x31, 0xe0, 0x29, 0x18, 0x20, 0x29, 0x39
  .byte 0xe1, 0x31, 0x29, 0x31, 0x41, 0xe2, 0x43, 0x39, 0x31, 0xe3, 0x3d, 0xff
section_B:
  .byte 0xe0, 0x39, 0x39, 0x39, 0x30, 0x28, 0xe1, 0x39, 0x39, 0x39, 0x30, 0x28, 0xe2, 0x3b, 0x42, 0x38
  .byte 0xe3, 0x35, 0xe0, 0x39, 0x39, 0x39, 0x30, 0x28, 0xe1, 0x3b, 0x39, 0x40, 0x38, 0xe2, 0x33, 0x2a
  .byte 0x30, 0xe3, 0x25, 0xe0, 0x53, 0x4a, 0x40, 0xe1, 0x3c, 0x31, 0xe2, 0x2c, 0x19, 0xe3, 0x34, 0x29
  .byte 0xe0, 0x19, 0x21, 0x29, 0x31, 0xe1, 0x3c, 0x30, 0x28, 0xe2, 0x44, 0x39, 0xe3, 0x35, 0xff
section_C:
  .byte 0xe0, 0x39, 0x39, 0x39, 0x30, 0x28, 0xe1, 0x39, 0x39, 0x39, 0x30, 0x28, 0xe2, 0x44, 0x39, 0xe3
  .byte 0x35, 0xe0, 0x39, 0x39, 0x39, 0x30, 0x28, 0xe1, 0x3b, 0x39, 0x40, 0x38, 0xe2, 0x33, 0x2a, 0x30
  .byte 0xe3, 0x25, 0xff
section_D:
  .byte 0xe0, 0x3b, 0x6b, 0xe1, 0x33, 0x6b, 0xe2, 0x2b, 0x6b, 0xe3, 0x23, 0x6b, 0xe1, 0x2b, 0x6b, 0xe2
  .byte 0x33, 0x6b, 0xe4, 0x43, 0x6b, 0xe3, 0x3b, 0x6b, 0xe0, 0x3c, 0x49, 0xe1, 0x44, 0x41, 0xe2, 0x49
  .byte 0x41, 0x41, 0x39, 0xe3, 0x35, 0xe0, 0x33, 0x3b, 0xe1, 0x3b, 0x43, 0xe2, 0x4b, 0x41, 0x39, 0xe3
  .byte 0x45, 0xff
section_F:
  .byte 0xe0, 0x6d, 0xf6, 0x6d, 0xe2, 0x6d, 0xf4, 0x6d, 0xe0, 0x6d, 0xf2, 0x6d, 0xe2, 0x6d, 0xf8, 0x6d
  .byte 0xff
