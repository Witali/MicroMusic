/* GENERATED FROM score.json BY score_compiler.py. */
playlist:
  .byte 0x00, 0x00, 0x00   /* playlist section indices (no sentinel) */
durations:
  .byte 0x0b, 0x16, 0x21, 0x2c, 0x42, 0x58, 0xb0   /* ticks @ 100 BPM, 512 PWM periods/tick */
note_steps:
  .byte 0x92, 0x03   /* C4, 523.0 Hz */
  .byte 0x02, 0x04   /* D4, 587.1 Hz */
  .byte 0x80, 0x04   /* E4, 659.2 Hz */
chord_steps:
  .byte 0x5f, 0x03, 0x87, 0x02   /* Bm: piano B3, guitar F#3 */
  .byte 0x40, 0x02, 0xb0, 0x01   /* Em: piano E3, guitar B2 */
section_offsets:
  .byte 0x00   /* byte offsets in melody_data */
melody_data:
section_A:
  .byte 0xe0, 0x03, 0x0b, 0xe1, 0x13, 0x1b, 0xff
